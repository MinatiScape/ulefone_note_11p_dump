/dts-v1/;

/ {

	__fixups__ {
		accdet = "/fragment@24:target:0\0/fragment@75:target:0";
		als = "/fragment@20:target:0\0/fragment@74:target:0";
		audgpio = "/fragment@26:target:0";
		auxadc = "/fragment@52:target:0\0/fragment@53/__overlay__:io-channels:0";
		charger = "/fragment@37:target:0";
		chosen = "/fragment@0:target:0";
		consys = "/fragment@29:target:0";
		cust_accel_bmi160 = "/fragment@2:target:0";
		cust_accel_icm426xx = "/fragment@4:target:0";
		cust_accel_mir3da = "/fragment@3:target:0";
		cust_accel_mxc6655 = "/fragment@5:target:0";
		cust_accel_sc7a20 = "/fragment@6:target:0";
		cust_accel_stk832x = "/fragment@7:target:0";
		cust_alsps_ltr559 = "/fragment@9:target:0";
		cust_alsps_stk3332_auto = "/fragment@11:target:0";
		cust_alsps_stk3332sv_auto = "/fragment@12:target:0";
		cust_alsps_stk3x1x_auto = "/fragment@8:target:0";
		cust_alsps_stk3x3x_auto = "/fragment@10:target:0";
		cust_gyro_bmi160 = "/fragment@13:target:0";
		cust_gyro_icm426xx = "/fragment@14:target:0";
		cust_mag_mmc5603x = "/fragment@15:target:0";
		dsi_te = "/fragment@82:target:0";
		finger = "/fragment@47:target:0";
		goodix_fp = "/fragment@76:target:0";
		gpio = "/fragment@68:target:0";
		gpio_usage_mapping = "/fragment@67:target:0";
		gyro = "/fragment@21:target:0\0/fragment@72:target:0";
		hall_1 = "/fragment@80:target:0";
		i2c0 = "/fragment@38:target:0\0/fragment@55:target:0";
		i2c1 = "/fragment@39:target:0\0/fragment@56:target:0";
		i2c10 = "/fragment@65:target:0";
		i2c11 = "/fragment@66:target:0";
		i2c2 = "/fragment@57:target:0";
		i2c3 = "/fragment@40:target:0\0/fragment@58:target:0";
		i2c4 = "/fragment@59:target:0";
		i2c5 = "/fragment@60:target:0";
		i2c6 = "/fragment@41:target:0\0/fragment@61:target:0";
		i2c7 = "/fragment@62:target:0";
		i2c8 = "/fragment@63:target:0";
		i2c9 = "/fragment@64:target:0";
		irtx_pwm = "/fragment@32:target:0";
		kd_camera_hw1 = "/fragment@31:target:0\0/fragment@94:target:0";
		keypad = "/fragment@22:target:0\0/fragment@96:target:0";
		lcm_mode = "/fragment@48:target:0";
		main_pmic = "/fragment@83:target:0";
		md1_sim1_hot_plug_eint = "/fragment@85:target:0";
		md1_sim2_hot_plug_eint = "/fragment@86:target:0";
		md_auxadc = "/fragment@53:target:0";
		mrdump_ext_rst = "/fragment@69:target:0";
		msdc1_ins = "/fragment@71:target:0";
		mse = "/fragment@73:target:0";
		mt6370_pmu = "/fragment@34:target:0";
		mt6370_typec = "/fragment@35:target:0";
		mt_pmic_vcama1_ldo_reg = "/fragment@31/__overlay__:cam1_vcama-supply:0\0/fragment@87:target:0\0/fragment@94/__overlay__:vcama_sub-supply:0";
		mt_pmic_vcama2_ldo_reg = "/fragment@31/__overlay__:cam0_vcama-supply:0\0/fragment@88:target:0\0/fragment@94/__overlay__:vcama-supply:0";
		mt_pmic_vcamd_ldo_reg = "/fragment@31/__overlay__:cam1_vcamd-supply:0\0/fragment@91:target:0\0/fragment@94/__overlay__:vcamd_sub-supply:0";
		mt_pmic_vcamio_ldo_reg = "/fragment@31/__overlay__:cam0_vcamio-supply:0\0/fragment@31/__overlay__:cam1_vcamio-supply:0\0/fragment@31/__overlay__:cam2_vcamio-supply:0\0/fragment@31/__overlay__:cam3_vcamio-supply:0\0/fragment@92:target:0\0/fragment@94/__overlay__:vcamio-supply:0\0/fragment@94/__overlay__:vcamio_sub-supply:0\0/fragment@94/__overlay__:vcamio_main2-supply:0\0/fragment@94/__overlay__:vcamio_sub2-supply:0";
		mt_pmic_vldo28_ldo_reg = "/fragment@31/__overlay__:cam0_vcamaf-supply:0\0/fragment@31/__overlay__:cam2_vcamaf-supply:0\0/fragment@93:target:0\0/fragment@94/__overlay__:vcamaf-supply:0\0/fragment@94/__overlay__:vcamaf_sub-supply:0\0/fragment@94/__overlay__:vcamaf_main2-supply:0\0/fragment@95/__overlay__:vtouch-supply:0";
		mt_pmic_vsim1_ldo_reg = "/fragment@89:target:0";
		mt_pmic_vsim2_ldo_reg = "/fragment@90:target:0";
		mtkfb = "/fragment@51:target:0";
		nfc = "/fragment@79:target:0";
		odm = "/fragment@1:target:0";
		pio = "/fragment@18:target:0\0/fragment@19:target:0\0/fragment@23:target:0\0/fragment@25:target:0\0/fragment@27:target:0\0/fragment@28:target:0\0/fragment@30:target:0\0/fragment@33:target:0\0/fragment@34/__overlay__:mt6370,intr_gpio:0\0/fragment@35/__overlay__:mt6370pd,intr_gpio:0\0/fragment@36:target:0\0/fragment@40/__overlay__/aw87339@58:reset-gpio:0\0/fragment@41/__overlay__/rt9465@4b:rt,en_gpio:0\0/fragment@41/__overlay__/rt9465@4b:rt,intr_gpio:0\0/fragment@42:target:0\0/fragment@46:target:0\0/fragment@47/__overlay__:fpreset-gpio:0\0/fragment@47/__overlay__:fpint-gpio:0\0/fragment@47/__overlay__:fppower-gpio:0\0/fragment@47/__overlay__:interrupt-parent:0\0/fragment@49:target:0\0/fragment@50:target:0\0/fragment@67/__overlay__:GPIO_SIM2_SIO:0\0/fragment@67/__overlay__:GPIO_SIM2_SRST:0\0/fragment@67/__overlay__:GPIO_SIM2_SCLK:0\0/fragment@67/__overlay__:GPIO_SIM1_SCLK:0\0/fragment@67/__overlay__:GPIO_SIM1_SRST:0\0/fragment@67/__overlay__:GPIO_SIM1_SIO:0\0/fragment@67/__overlay__:GPIO_SIM2_HOT_PLUG:0\0/fragment@67/__overlay__:GPIO_SIM1_HOT_PLUG:0\0/fragment@69/__overlay__:interrupt-parent:0\0/fragment@69/__overlay__:deb-gpios:0\0/fragment@70/__overlay__:interrupt-parent:0\0/fragment@71/__overlay__:interrupt-parent:0\0/fragment@71/__overlay__:deb-gpios:0\0/fragment@72/__overlay__:interrupt-parent:0\0/fragment@73/__overlay__:interrupt-parent:0\0/fragment@74/__overlay__:interrupt-parent:0\0/fragment@75/__overlay__:interrupt-parent:0\0/fragment@75/__overlay__:deb-gpios:0\0/fragment@76/__overlay__:interrupt-parent:0\0/fragment@77/__overlay__:interrupt-parent:0\0/fragment@78/__overlay__:interrupt-parent:0\0/fragment@79/__overlay__:interrupt-parent:0\0/fragment@80/__overlay__:interrupt-parent:0\0/fragment@81/__overlay__:interrupt-parent:0\0/fragment@82/__overlay__:interrupt-parent:0\0/fragment@83/__overlay__:interrupt-parent:0\0/fragment@84/__overlay__:interrupt-parent:0";
		pmic_clock_buffer_ctrl = "/fragment@54:target:0";
		rt9465_slave_chr = "/fragment@77:target:0";
		scp = "/fragment@16:target:0";
		smart_pa = "/fragment@84:target:0";
		spi0 = "/fragment@44:target:0\0/fragment@45:target:0";
		subpmic_pmu_eint = "/fragment@78:target:0";
		tcpc_pd = "/fragment@81:target:0";
		temp = "/fragment@43:target:0";
		touch = "/fragment@17:target:0\0/fragment@70:target:0\0/fragment@95:target:0";
	};

	__local_fixups__ {

		fragment@1 {

			__overlay__ {

				usb_c_pinctrl {
					pinctrl-0 = <0x00>;
					pinctrl-1 = <0x00>;
					pinctrl-10 = <0x00>;
					pinctrl-11 = <0x00>;
					pinctrl-12 = <0x00>;
					pinctrl-2 = <0x00>;
					pinctrl-3 = <0x00>;
					pinctrl-4 = <0x00>;
					pinctrl-5 = <0x00>;
					pinctrl-6 = <0x00>;
					pinctrl-7 = <0x00>;
					pinctrl-8 = <0x00>;
					pinctrl-9 = <0x00>;
				};
			};
		};

		fragment@17 {

			__overlay__ {
				pinctrl-0 = <0x00>;
				pinctrl-1 = <0x00>;
				pinctrl-2 = <0x00>;
				pinctrl-3 = <0x00>;
				pinctrl-4 = <0x00>;
				pinctrl-5 = <0x00>;
				pinctrl-6 = <0x00>;
				pinctrl-7 = <0x00>;
			};
		};

		fragment@20 {

			__overlay__ {
				pinctrl-0 = <0x00>;
				pinctrl-1 = <0x00>;
			};
		};

		fragment@21 {

			__overlay__ {
				pinctrl-0 = <0x00>;
				pinctrl-1 = <0x00>;
			};
		};

		fragment@22 {

			__overlay__ {
				pinctrl-0 = <0x00>;
			};
		};

		fragment@24 {

			__overlay__ {
				pinctrl-0 = <0x00>;
				pinctrl-1 = <0x00>;
			};
		};

		fragment@26 {

			__overlay__ {
				pinctrl-0 = <0x00>;
				pinctrl-1 = <0x00>;
				pinctrl-10 = <0x00>;
				pinctrl-11 = <0x00>;
				pinctrl-2 = <0x00>;
				pinctrl-3 = <0x00>;
				pinctrl-4 = <0x00>;
				pinctrl-5 = <0x00>;
				pinctrl-6 = <0x00>;
				pinctrl-7 = <0x00>;
				pinctrl-8 = <0x00>;
				pinctrl-9 = <0x00>;
			};
		};

		fragment@29 {

			__overlay__ {
				pinctrl-0 = <0x00>;
				pinctrl-1 = <0x00>;
				pinctrl-2 = <0x00>;
				pinctrl-3 = <0x00>;
			};
		};

		fragment@31 {

			__overlay__ {
				pinctrl-0 = <0x00>;
				pinctrl-1 = <0x00>;
				pinctrl-10 = <0x00>;
				pinctrl-11 = <0x00>;
				pinctrl-12 = <0x00>;
				pinctrl-13 = <0x00>;
				pinctrl-14 = <0x00>;
				pinctrl-15 = <0x00>;
				pinctrl-16 = <0x00>;
				pinctrl-17 = <0x00>;
				pinctrl-18 = <0x00>;
				pinctrl-19 = <0x00>;
				pinctrl-2 = <0x00>;
				pinctrl-20 = <0x00>;
				pinctrl-21 = <0x00>;
				pinctrl-22 = <0x00>;
				pinctrl-23 = <0x00>;
				pinctrl-24 = <0x00>;
				pinctrl-25 = <0x00>;
				pinctrl-26 = <0x00>;
				pinctrl-27 = <0x00>;
				pinctrl-28 = <0x00>;
				pinctrl-29 = <0x00>;
				pinctrl-3 = <0x00>;
				pinctrl-30 = <0x00>;
				pinctrl-31 = <0x00>;
				pinctrl-32 = <0x00>;
				pinctrl-33 = <0x00>;
				pinctrl-34 = <0x00>;
				pinctrl-35 = <0x00>;
				pinctrl-36 = <0x00>;
				pinctrl-37 = <0x00>;
				pinctrl-38 = <0x00>;
				pinctrl-39 = <0x00>;
				pinctrl-4 = <0x00>;
				pinctrl-40 = <0x00>;
				pinctrl-41 = <0x00>;
				pinctrl-42 = <0x00>;
				pinctrl-43 = <0x00>;
				pinctrl-44 = <0x00>;
				pinctrl-45 = <0x00>;
				pinctrl-46 = <0x00>;
				pinctrl-47 = <0x00>;
				pinctrl-48 = <0x00>;
				pinctrl-49 = <0x00>;
				pinctrl-5 = <0x00>;
				pinctrl-50 = <0x00>;
				pinctrl-51 = <0x00>;
				pinctrl-52 = <0x00>;
				pinctrl-53 = <0x00>;
				pinctrl-54 = <0x00>;
				pinctrl-55 = <0x00>;
				pinctrl-56 = <0x00>;
				pinctrl-6 = <0x00>;
				pinctrl-7 = <0x00>;
				pinctrl-8 = <0x00>;
				pinctrl-9 = <0x00>;
			};
		};

		fragment@32 {

			__overlay__ {
				pinctrl-0 = <0x00>;
				pinctrl-1 = <0x00>;
			};
		};

		fragment@43 {

			__overlay__ {
				pinctrl-0 = <0x00>;
				pinctrl-1 = <0x00>;
				pinctrl-2 = <0x00>;
				pinctrl-3 = <0x00>;
				pinctrl-4 = <0x00>;
				pinctrl-5 = <0x00>;
			};
		};

		fragment@47 {

			__overlay__ {
				pinctrl-0 = <0x00>;
				pinctrl-1 = <0x00>;
				pinctrl-2 = <0x00>;
				pinctrl-3 = <0x00>;
				pinctrl-4 = <0x00>;
				pinctrl-5 = <0x00>;
			};
		};

		fragment@48 {

			__overlay__ {
				pinctrl-0 = <0x00>;
				pinctrl-1 = <0x00>;
				pinctrl-2 = <0x00>;
				pinctrl-3 = <0x00>;
			};
		};

		fragment@51 {

			__overlay__ {
				pinctrl-0 = <0x00>;
				pinctrl-1 = <0x00>;
				pinctrl-2 = <0x00>;
				pinctrl-3 = <0x00>;
				pinctrl-4 = <0x00>;
				pinctrl-5 = <0x00>;
				pinctrl-6 = <0x00>;
			};
		};
	};

	__symbols__ {
		accdet_pins_default = "/fragment@25/__overlay__/accdetdefault";
		accdet_pins_eint_as_int = "/fragment@25/__overlay__/accdeteint@0";
		alsps_intpin_cfg = "/fragment@19/__overlay__/alspspincfg";
		alsps_intpin_default = "/fragment@19/__overlay__/alspsdefaultcfg";
		alsps_mtk = "/fragment@56/__overlay__/alsps@51";
		aud_clk_mosi_off = "/fragment@27/__overlay__/aud_clk_mosi_off";
		aud_clk_mosi_on = "/fragment@27/__overlay__/aud_clk_mosi_on";
		aud_dat_miso_off = "/fragment@27/__overlay__/aud_dat_miso_off";
		aud_dat_miso_on = "/fragment@27/__overlay__/aud_dat_miso_on";
		aud_dat_mosi_off = "/fragment@27/__overlay__/aud_dat_mosi_off";
		aud_dat_mosi_on = "/fragment@27/__overlay__/aud_dat_mosi_on";
		aud_pins_smartpa_off = "/fragment@27/__overlay__/aud_pins_smartpa_off";
		aud_pins_smartpa_on = "/fragment@27/__overlay__/aud_pins_smartpa_on";
		barometer_mtk = "/fragment@56/__overlay__/barometer@77";
		camera_main_af_mtk = "/fragment@57/__overlay__/camera_main_af@72";
		camera_main_eeprom_mtk = "/fragment@57/__overlay__/camera_main_eeprom@50";
		camera_main_mtk = "/fragment@57/__overlay__/camera_main@1a";
		camera_main_two_af_mtk = "/fragment@59/__overlay__/camera_main_two_af@72";
		camera_main_two_eeprom_mtk = "/fragment@61/__overlay__/camera_main_two_eeprom@51";
		camera_main_two_mtk = "/fragment@61/__overlay__/camera_main_two@10";
		camera_pins_cam0_mclk_2ma = "/fragment@30/__overlay__/camera_pins_cam0_mclk_2ma";
		camera_pins_cam0_mclk_4ma = "/fragment@30/__overlay__/camera_pins_cam0_mclk_4ma";
		camera_pins_cam0_mclk_6ma = "/fragment@30/__overlay__/camera_pins_cam0_mclk_6ma";
		camera_pins_cam0_mclk_8ma = "/fragment@30/__overlay__/camera_pins_cam0_mclk_8ma";
		camera_pins_cam0_mclk_off = "/fragment@30/__overlay__/camera_pins_cam0_mclk_off";
		camera_pins_cam0_pnd_0 = "/fragment@30/__overlay__/cam0@2";
		camera_pins_cam0_pnd_1 = "/fragment@30/__overlay__/cam0@3";
		camera_pins_cam0_rst_0 = "/fragment@30/__overlay__/cam0@0";
		camera_pins_cam0_rst_1 = "/fragment@30/__overlay__/cam0@1";
		camera_pins_cam0_vcama_0 = "/fragment@30/__overlay__/cam0@vcam2";
		camera_pins_cam0_vcama_1 = "/fragment@30/__overlay__/cam0@vcam3";
		camera_pins_cam0_vcamd_0 = "/fragment@30/__overlay__/cam0@vcam0";
		camera_pins_cam0_vcamd_1 = "/fragment@30/__overlay__/cam0@vcam1";
		camera_pins_cam1_mclk_2ma = "/fragment@30/__overlay__/camera_pins_cam1_mclk_2ma";
		camera_pins_cam1_mclk_4ma = "/fragment@30/__overlay__/camera_pins_cam1_mclk_4ma";
		camera_pins_cam1_mclk_6ma = "/fragment@30/__overlay__/camera_pins_cam1_mclk_6ma";
		camera_pins_cam1_mclk_8ma = "/fragment@30/__overlay__/camera_pins_cam1_mclk_8ma";
		camera_pins_cam1_mclk_off = "/fragment@30/__overlay__/camera_pins_cam1_mclk_off";
		camera_pins_cam1_pnd_0 = "/fragment@30/__overlay__/cam1@2";
		camera_pins_cam1_pnd_1 = "/fragment@30/__overlay__/cam1@3";
		camera_pins_cam1_rst_0 = "/fragment@30/__overlay__/cam1@0";
		camera_pins_cam1_rst_1 = "/fragment@30/__overlay__/cam1@1";
		camera_pins_cam1_vcama_0 = "/fragment@30/__overlay__/cam1@vcam2";
		camera_pins_cam1_vcama_1 = "/fragment@30/__overlay__/cam1@vcam3";
		camera_pins_cam1_vcamd_0 = "/fragment@30/__overlay__/cam1@vcam0";
		camera_pins_cam1_vcamd_1 = "/fragment@30/__overlay__/cam1@vcam1";
		camera_pins_cam2_mclk_2ma = "/fragment@30/__overlay__/camera_pins_cam2_mclk_2ma";
		camera_pins_cam2_mclk_4ma = "/fragment@30/__overlay__/camera_pins_cam2_mclk_4ma";
		camera_pins_cam2_mclk_6ma = "/fragment@30/__overlay__/camera_pins_cam2_mclk_6ma";
		camera_pins_cam2_mclk_8ma = "/fragment@30/__overlay__/camera_pins_cam2_mclk_8ma";
		camera_pins_cam2_mclk_off = "/fragment@30/__overlay__/camera_pins_cam2_mclk_off";
		camera_pins_cam2_pnd_0 = "/fragment@30/__overlay__/cam2@2";
		camera_pins_cam2_pnd_1 = "/fragment@30/__overlay__/cam2@3";
		camera_pins_cam2_rst_0 = "/fragment@30/__overlay__/cam2@0";
		camera_pins_cam2_rst_1 = "/fragment@30/__overlay__/cam2@1";
		camera_pins_cam2_vcama_0 = "/fragment@30/__overlay__/cam2@vcam2";
		camera_pins_cam2_vcama_1 = "/fragment@30/__overlay__/cam2@vcam3";
		camera_pins_cam2_vcamd_0 = "/fragment@30/__overlay__/cam2@vcam0";
		camera_pins_cam2_vcamd_1 = "/fragment@30/__overlay__/cam2@vcam1";
		camera_pins_cam3_mclk_2ma = "/fragment@30/__overlay__/camera_pins_cam3_mclk_2ma";
		camera_pins_cam3_mclk_4ma = "/fragment@30/__overlay__/camera_pins_cam3_mclk_4ma";
		camera_pins_cam3_mclk_6ma = "/fragment@30/__overlay__/camera_pins_cam3_mclk_6ma";
		camera_pins_cam3_mclk_8ma = "/fragment@30/__overlay__/camera_pins_cam3_mclk_8ma";
		camera_pins_cam3_mclk_off = "/fragment@30/__overlay__/camera_pins_cam3_mclk_off";
		camera_pins_cam3_pnd_0 = "/fragment@30/__overlay__/cam3@2";
		camera_pins_cam3_pnd_1 = "/fragment@30/__overlay__/cam3@3";
		camera_pins_cam3_rst_0 = "/fragment@30/__overlay__/cam3@0";
		camera_pins_cam3_rst_1 = "/fragment@30/__overlay__/cam3@1";
		camera_pins_cam3_vcama_0 = "/fragment@30/__overlay__/cam3@vcam2";
		camera_pins_cam3_vcama_1 = "/fragment@30/__overlay__/cam3@vcam3";
		camera_pins_cam3_vcamd_0 = "/fragment@30/__overlay__/cam3@vcam0";
		camera_pins_cam3_vcamd_1 = "/fragment@30/__overlay__/cam3@vcam1";
		camera_pins_default = "/fragment@30/__overlay__/camdefault";
		camera_pins_mipi_switch_en_0 = "/fragment@30/__overlay__/mipiswitchen@0";
		camera_pins_mipi_switch_en_1 = "/fragment@30/__overlay__/mipiswitchen@1";
		camera_pins_mipi_switch_sel_0 = "/fragment@30/__overlay__/mipiswitchsel@0";
		camera_pins_mipi_switch_sel_1 = "/fragment@30/__overlay__/mipiswitchsel@1";
		camera_sub_eeprom_mtk = "/fragment@59/__overlay__/camera_sub_eeprom@54";
		camera_sub_mtk = "/fragment@59/__overlay__/camera_sub@35";
		cap_touch_mtk = "/fragment@55/__overlay__/cap_touch@5d";
		ccu_sensor_i2c_main2_hw_mtk = "/fragment@61/__overlay__/ccu_sensor_i2c_main2_hw@36";
		ccu_sensor_i2c_main3_hw_mtk = "/fragment@59/__overlay__/ccu_sensor_i2c_main3_hw@11";
		ccu_sensor_i2c_main_hw_mtk = "/fragment@57/__overlay__/ccu_sensor_i2c_main_hw@33";
		ccu_sensor_i2c_sub_hw_mtk = "/fragment@59/__overlay__/ccu_sensor_i2c_sub_hw@43";
		consys_pins_default = "/fragment@28/__overlay__/consys_default";
		ctp_pins_2v8_output0 = "/fragment@18/__overlay__/2v8output0";
		ctp_pins_2v8_output1 = "/fragment@18/__overlay__/2v8output1";
		ctp_pins_default = "/fragment@18/__overlay__/eint0default";
		ctp_pins_eint_as_int = "/fragment@18/__overlay__/eint@0";
		ctp_pins_eint_output0 = "/fragment@18/__overlay__/eintoutput0";
		ctp_pins_eint_output1 = "/fragment@18/__overlay__/eintoutput1";
		ctp_pins_rst_output0 = "/fragment@18/__overlay__/rstoutput0";
		ctp_pins_rst_output1 = "/fragment@18/__overlay__/rstoutput1";
		finger_power_2v8_high = "/fragment@46/__overlay__/fp_power_2v8_high";
		finger_power_2v8_low = "/fragment@46/__overlay__/fp_power_2v8_low";
		fp_int_default = "/fragment@46/__overlay__/fp_int_def";
		fp_reset_output_high = "/fragment@46/__overlay__/fp_rst_high";
		fp_reset_output_low = "/fragment@46/__overlay__/fp_rst_low";
		fp_spi_default = "/fragment@46/__overlay__/fp_spi";
		gpio_redriver_c1_high = "/fragment@36/__overlay__/c1_high";
		gpio_redriver_c1_hiz = "/fragment@36/__overlay__/c1_highz";
		gpio_redriver_c1_init = "/fragment@36/__overlay__/c1_init";
		gpio_redriver_c1_low = "/fragment@36/__overlay__/c1_low";
		gpio_redriver_c2_high = "/fragment@36/__overlay__/c2_high";
		gpio_redriver_c2_hiz = "/fragment@36/__overlay__/c2_highz";
		gpio_redriver_c2_init = "/fragment@36/__overlay__/c2_init";
		gpio_redriver_c2_low = "/fragment@36/__overlay__/c2_low";
		gpio_u3_switch_disable = "/fragment@36/__overlay__/u3_sw_dis";
		gpio_u3_switch_enable = "/fragment@36/__overlay__/u3_sw_en";
		gpio_u3_switch_sel1 = "/fragment@36/__overlay__/u3_sw_sel1";
		gpio_u3_switch_sel2 = "/fragment@36/__overlay__/u3_sw_sel2";
		gpslna_pins_init = "/fragment@28/__overlay__/gpslna@0";
		gpslna_pins_oh = "/fragment@28/__overlay__/gpslna@1";
		gpslna_pins_ol = "/fragment@28/__overlay__/gpslna@2";
		gyro_intpin_cfg = "/fragment@19/__overlay__/gyropincfg";
		gyro_intpin_default = "/fragment@19/__overlay__/gyrodefaultcfg";
		i2c_scl1_pio = "/fragment@42/__overlay__/i2c_scl1_pio";
		i2c_sda1_pio = "/fragment@42/__overlay__/i2c_sda1_pio";
		irtx_gpio_led_default = "/fragment@33/__overlay__/irtx_gpio_led_def@gpio90";
		irtx_gpio_led_set = "/fragment@33/__overlay__/irtx_gpio_led_set@gpio90";
		kpd_pins_default = "/fragment@23/__overlay__/kpdgpiodefault";
		lcm_rst = "/fragment@49/__overlay__/lcm_rst_gpio_mode1@gpio45";
		lcm_rst_default = "/fragment@49/__overlay__/lcmrstdefault";
		lcm_rst_gpio_high = "/fragment@49/__overlay__/lcm_rst_gpio_mode2@gpio45";
		lcm_rst_gpio_low = "/fragment@49/__overlay__/lcm_rst_gpio_mode3@gpio45";
		led0 = "/fragment@1/__overlay__/led@0";
		led1 = "/fragment@1/__overlay__/led@1";
		led2 = "/fragment@1/__overlay__/led@2";
		led3 = "/fragment@1/__overlay__/led@3";
		led4 = "/fragment@1/__overlay__/led@4";
		led5 = "/fragment@1/__overlay__/led@5";
		led6 = "/fragment@1/__overlay__/led@6";
		msensor_mtk = "/fragment@56/__overlay__/msensor@0c";
		mtkfb_pins_default = "/fragment@50/__overlay__/mtkfb_default";
		mtkfb_pins_lcd_bias_enp0 = "/fragment@50/__overlay__/lcd_bias_enp0_gpio";
		mtkfb_pins_lcd_bias_enp1 = "/fragment@50/__overlay__/lcd_bias_enp1_gpio";
		mtkfb_pins_lcm_reset0 = "/fragment@50/__overlay__/lcm_rst_out0_gpio";
		mtkfb_pins_lcm_reset1 = "/fragment@50/__overlay__/lcm_rst_out1_gpio";
		mtkfb_pins_mode_te_gpio = "/fragment@50/__overlay__/mode_te_gpio";
		mtkfb_pins_mode_te_te = "/fragment@50/__overlay__/mode_te_te";
		nfc_mtk = "/fragment@58/__overlay__/nfc@08";
		slave_charger_mtk = "/fragment@61/__overlay__/slave_charger@4b";
		speaker_amp_mtk = "/fragment@61/__overlay__/speaker_amp@34";
		subpmic_pmu_mtk = "/fragment@60/__overlay__/subpmic_pmu@34";
		temp_intpin_cfg = "/fragment@42/__overlay__/temppincfg";
		temp_intpin_default = "/fragment@42/__overlay__/tempdefaultcfg";
		temp_pin_en_high = "/fragment@42/__overlay__/tempen@1";
		temp_pin_en_low = "/fragment@42/__overlay__/tempen@0";
		usb_c_pinctrl = "/fragment@1/__overlay__/usb_c_pinctrl";
		usb_default = "/fragment@36/__overlay__/usb_default";
		usb_type_c_mtk = "/fragment@60/__overlay__/usb_type_c@4e";
		vibrator0 = "/fragment@1/__overlay__/vibrator@0";
		vow_clk_miso_off = "/fragment@27/__overlay__/vow_clk_miso_off";
		vow_clk_miso_on = "/fragment@27/__overlay__/vow_clk_miso_on";
		vow_dat_miso_off = "/fragment@27/__overlay__/vow_dat_miso_off";
		vow_dat_miso_on = "/fragment@27/__overlay__/vow_dat_miso_on";
	};

	fragment@0 {
		target = <0xffffffff>;

		__overlay__ {
			atag,videolfb-fb_base_h = <0x00>;
			atag,videolfb-fb_base_l = "^`P";
			atag,videolfb-fps = <0x1770>;
			atag,videolfb-islcm_inited = <0x00>;
			atag,videolfb-islcmfound = <0x01>;
			atag,videolfb-lcmname = "nt35595_fhd_dsi_cmd_truly_nt50358_drv";
			atag,videolfb-vramSize = <0x17bb000>;
		};
	};

	fragment@1 {
		target = <0xffffffff>;

		__overlay__ {

			led@0 {
				compatible = "mediatek,red";
				data = <0x01>;
				led_mode = <0x00>;
				phandle = <0x7f>;
				pwm_config = <0x00 0x00 0x00 0x00 0x00>;
			};

			led@1 {
				compatible = "mediatek,green";
				data = <0x01>;
				led_mode = <0x00>;
				phandle = <0x80>;
				pwm_config = <0x00 0x00 0x00 0x00 0x00>;
			};

			led@2 {
				compatible = "mediatek,blue";
				data = <0x01>;
				led_mode = <0x00>;
				phandle = <0x81>;
				pwm_config = <0x00 0x00 0x00 0x00 0x00>;
			};

			led@3 {
				compatible = "mediatek,jogball-backlight";
				data = <0x01>;
				led_mode = <0x00>;
				phandle = <0x82>;
				pwm_config = <0x00 0x00 0x00 0x00 0x00>;
			};

			led@4 {
				compatible = "mediatek,keyboard-backlight";
				data = <0x01>;
				led_mode = <0x00>;
				phandle = <0x83>;
				pwm_config = <0x00 0x00 0x00 0x00 0x00>;
			};

			led@5 {
				compatible = "mediatek,button-backlight";
				data = <0x01>;
				led_mode = <0x00>;
				phandle = <0x84>;
				pwm_config = <0x00 0x00 0x00 0x00 0x00>;
			};

			led@6 {
				compatible = "mediatek,lcd-backlight";
				data = <0x01>;
				led_mode = <0x05>;
				phandle = <0x85>;
				pwm_config = <0x00 0x01 0x00 0x00 0x00>;
			};

			usb_c_pinctrl {
				compatible = "mediatek,usb_c_pinctrl";
				phandle = <0x87>;
				pinctrl-0 = <0x01>;
				pinctrl-1 = <0x02>;
				pinctrl-10 = <0x0b>;
				pinctrl-11 = <0x0c>;
				pinctrl-12 = <0x0d>;
				pinctrl-2 = <0x03>;
				pinctrl-3 = <0x04>;
				pinctrl-4 = <0x05>;
				pinctrl-5 = <0x06>;
				pinctrl-6 = <0x07>;
				pinctrl-7 = <0x08>;
				pinctrl-8 = <0x09>;
				pinctrl-9 = <0x0a>;
				pinctrl-names = "usb_default\0redrv_c1_init\0redrv_c1_low\0redrv_c1_hiz\0redrv_c1_high\0redrv_c2_init\0redrv_c2_low\0redrv_c2_hiz\0redrv_c2_high\0switch_sel1\0switch_sel2\0switch_enable\0switch_disable";
				status = "okay";

				usb_switch-data {
					c1_pin_num = <0x12>;
					c1_pin_val = <0x02>;
					c2_pin_num = <0x11>;
					c2_pin_val = <0x01>;
					en_pin_num = <0x00>;
					en_pin_val = <0x00>;
					sel_pin_num = <0xb1>;
					sel_pin_val = <0x01>;
				};
			};

			vibrator@0 {
				compatible = "mediatek,vibrator";
				phandle = <0x86>;
				vib_limit = <0x09>;
				vib_timer = <0x19>;
				vib_vol = <0x09>;
			};
		};
	};

	fragment@10 {
		target = <0xffffffff>;

		__overlay__ {
			als_level = <0x05 0x09 0x24 0x3b 0x52 0x84 0xcd 0x111 0x1f4 0x34d 0x470 0x609 0x93c 0x122f 0x1b46>;
			als_value = <0x0a 0x0a 0x28 0x41 0x5a 0x91 0xe1 0x12c 0x226 0x3a2 0x4e2 0x6a4 0xa28 0x1400 0x1e00 0x2800>;
			i2c_addr = <0x67 0x00 0x00 0x00>;
			i2c_num = <0x01>;
			is_batch_supported_als = <0x00>;
			is_batch_supported_ps = <0x00>;
			polling_mode_als = <0x01>;
			polling_mode_ps = <0x00>;
			power_id = <0xffff>;
			power_vol = <0x00>;
			ps_threshold_high = <0x5a>;
			ps_threshold_low = <0x46>;
		};
	};

	fragment@11 {
		target = <0xffffffff>;

		__overlay__ {
			als_level = <0x05 0x09 0x24 0x3b 0x52 0x84 0xcd 0x111 0x1f4 0x34d 0x470 0x609 0x93c 0x122f 0x1b46>;
			als_value = <0x0a 0x0a 0x28 0x41 0x5a 0x91 0xe1 0x12c 0x226 0x3a2 0x4e2 0x6a4 0xa28 0x1400 0x1e00 0x2800>;
			i2c_addr = <0x47 0x00 0x00 0x00>;
			i2c_num = <0x01>;
			is_batch_supported_als = <0x00>;
			is_batch_supported_ps = <0x00>;
			polling_mode_als = <0x01>;
			polling_mode_ps = <0x00>;
			power_id = <0xffff>;
			power_vol = <0x00>;
			ps_threshold_high = <0x5a>;
			ps_threshold_low = <0x46>;
		};
	};

	fragment@12 {
		target = <0xffffffff>;

		__overlay__ {
			als_level = <0x05 0x09 0x24 0x3b 0x52 0x84 0xcd 0x111 0x1f4 0x34d 0x470 0x609 0x93c 0x122f 0x1b46>;
			als_value = <0x0a 0x0a 0x28 0x41 0x5a 0x91 0xe1 0x12c 0x226 0x3a2 0x4e2 0x6a4 0xa28 0x1400 0x1e00 0x2800>;
			i2c_addr = <0x77 0x00 0x00 0x00>;
			i2c_num = <0x01>;
			is_batch_supported_als = <0x00>;
			is_batch_supported_ps = <0x00>;
			polling_mode_als = <0x01>;
			polling_mode_ps = <0x00>;
			power_id = <0xffff>;
			power_vol = <0x00>;
			ps_threshold_high = <0x5a>;
			ps_threshold_low = <0x46>;
		};
	};

	fragment@13 {
		target = <0xffffffff>;

		__overlay__ {
			direction = <0x05>;
			firlen = <0x00>;
			i2c_addr = <0x69 0x00 0x00 0x00>;
			i2c_num = <0x01>;
			is_batch_supported = <0x00>;
			power_id = <0xffff>;
			power_vol = <0x00>;
		};
	};

	fragment@14 {
		target = <0xffffffff>;

		__overlay__ {
			direction = <0x02>;
			firlen = <0x00>;
			i2c_addr = <0x66 0x00 0x00 0x00>;
			i2c_num = <0x01>;
			is_batch_supported = <0x00>;
			power_id = <0xffff>;
			power_vol = <0x00>;
		};
	};

	fragment@15 {
		target = <0xffffffff>;

		__overlay__ {
			direction = <0x07>;
			firlen = <0x00>;
			i2c_addr = <0x30 0x00 0x00 0x00>;
			i2c_num = <0x01>;
			is_batch_supported = <0x00>;
			power_id = <0xffff>;
			power_vol = <0x00>;
		};
	};

	fragment@16 {
		target = <0xffffffff>;

		__overlay__ {
			core_1 = "enable";
			scp_sramSize = <0x80000>;
		};
	};

	fragment@17 {
		target = <0xffffffff>;

		__overlay__ {
			pinctrl-0 = <0x0e>;
			pinctrl-1 = <0x0f>;
			pinctrl-2 = <0x10>;
			pinctrl-3 = <0x11>;
			pinctrl-4 = <0x12>;
			pinctrl-5 = <0x13>;
			pinctrl-6 = <0x14>;
			pinctrl-7 = <0x15>;
			pinctrl-names = "default\0state_eint_as_int\0state_eint_output0\0state_eint_output1\0state_rst_output0\0state_rst_output1\0state_2v8_output0\0state_2v8_output1";
			status = "okay";
			tpd-filter-custom-prameters = <0x00 0x00 0x00 0x00 0x00 0x00 0x00 0x00 0x00 0x00 0x00 0x00>;
			tpd-filter-custom-speed = <0x00 0x00 0x00>;
			tpd-filter-enable = <0x01>;
			tpd-filter-pixel-density = <0x92>;
			tpd-key-dim-local = <0x5a 0x373 0x64 0x28 0xe6 0x373 0x64 0x28 0x172 0x373 0x64 0x28 0x00 0x00 0x00 0x00>;
			tpd-key-local = <0x8b 0xac 0x9e 0x00>;
			tpd-key-num = <0x03>;
			tpd-max-touch-num = <0x05>;
			tpd-resolution = <0x438 0x924>;
			use-tpd-button = <0x00>;
		};
	};

	fragment@18 {
		target = <0xffffffff>;

		__overlay__ {

			2v8output0 {
				phandle = <0x14>;

				pins_cmd_dat {
					output-low;
					pinmux = <0x4f00>;
					slew-rate = <0x01>;
				};
			};

			2v8output1 {
				phandle = <0x15>;

				pins_cmd_dat {
					output-high;
					pinmux = <0x4f00>;
					slew-rate = <0x01>;
				};
			};

			eint0default {
				phandle = <0x0e>;
			};

			eint@0 {
				phandle = <0x0f>;

				pins_cmd_dat {
					bias-disable;
					pinmux = <0x100>;
					slew-rate = <0x00>;
				};
			};

			eintoutput0 {
				phandle = <0x10>;

				pins_cmd_dat {
					output-low;
					pinmux = <0x100>;
					slew-rate = <0x01>;
				};
			};

			eintoutput1 {
				phandle = <0x11>;

				pins_cmd_dat {
					output-high;
					pinmux = <0x100>;
					slew-rate = <0x01>;
				};
			};

			rstoutput0 {
				phandle = <0x12>;

				pins_cmd_dat {
					output-low;
					pinmux = <0x200>;
					slew-rate = <0x01>;
				};
			};

			rstoutput1 {
				phandle = <0x13>;

				pins_cmd_dat {
					output-high;
					pinmux = <0x200>;
					slew-rate = <0x01>;
				};
			};
		};
	};

	fragment@19 {
		target = <0xffffffff>;

		__overlay__ {

			alspsdefaultcfg {
				phandle = <0x16>;
			};

			alspspincfg {
				phandle = <0x17>;

				pins_cmd_dat {
					bias-pull-up = <0x00>;
					pinmux = <0x600>;
					slew-rate = <0x00>;
				};
			};

			gyrodefaultcfg {
				phandle = <0x18>;
			};

			gyropincfg {
				phandle = <0x19>;

				pins_cmd_dat {
					bias-pull-down = <0x00>;
					pinmux = <0x400>;
					slew-rate = <0x00>;
				};
			};
		};
	};

	fragment@2 {
		target = <0xffffffff>;

		__overlay__ {
			direction = <0x05>;
			firlen = <0x00>;
			i2c_addr = <0x68 0x00 0x00 0x00>;
			i2c_num = <0x01>;
			is_batch_supported = <0x00>;
			power_id = <0xffff>;
			power_vol = <0x00>;
		};
	};

	fragment@20 {
		target = <0xffffffff>;

		__overlay__ {
			pinctrl-0 = <0x16>;
			pinctrl-1 = <0x17>;
			pinctrl-names = "pin_default\0pin_cfg";
			status = "okay";
		};
	};

	fragment@21 {
		target = <0xffffffff>;

		__overlay__ {
			pinctrl-0 = <0x18>;
			pinctrl-1 = <0x19>;
			pinctrl-names = "pin_default\0pin_cfg";
			status = "okay";
		};
	};

	fragment@22 {
		target = <0xffffffff>;

		__overlay__ {
			pinctrl-0 = <0x1a>;
			pinctrl-names = "default";
		};
	};

	fragment@23 {
		target = <0xffffffff>;

		__overlay__ {

			kpdgpiodefault {
				phandle = <0x1a>;

				pins_cmd_dat {
					bias-pull-up = <0x66>;
					input-schmitt-enable;
					output-low;
					pinmux = <0x5d01>;
				};
			};
		};
	};

	fragment@24 {
		target = <0xffffffff>;

		__overlay__ {
			accdet-mic-mode = <0x01>;
			accdet-mic-vol = <0x06>;
			accdet-plugout-debounce = <0x01>;
			headset-eint-level-pol = <0x08>;
			headset-four-key-threshold = <0x00 0x3a 0x79 0xc0 0x190>;
			headset-mode-setting = <0x500 0x500 0x01 0x1f0 0x800 0x800 0x20 0x44>;
			headset-three-key-threshold = <0x00 0x50 0xdc 0x190>;
			headset-three-key-threshold-CDD = <0x00 0x79 0xc0 0x258>;
			pinctrl-0 = <0x1b>;
			pinctrl-1 = <0x1c>;
			pinctrl-names = "default\0state_eint_as_int";
			status = "okay";
		};
	};

	fragment@25 {
		target = <0xffffffff>;

		__overlay__ {

			accdetdefault {
				phandle = <0x1b>;
			};

			accdeteint@0 {
				phandle = <0x1c>;

				pins_cmd_dat {
					bias-disable;
					pinmux = <0x700>;
					slew-rate = <0x00>;
				};
			};
		};
	};

	fragment@26 {
		target = <0xffffffff>;

		__overlay__ {
			pinctrl-0 = <0x1d>;
			pinctrl-1 = <0x1e>;
			pinctrl-10 = <0x27>;
			pinctrl-11 = <0x28>;
			pinctrl-2 = <0x1f>;
			pinctrl-3 = <0x20>;
			pinctrl-4 = <0x21>;
			pinctrl-5 = <0x22>;
			pinctrl-6 = <0x23>;
			pinctrl-7 = <0x24>;
			pinctrl-8 = <0x25>;
			pinctrl-9 = <0x26>;
			pinctrl-names = "aud_clk_mosi_off\0aud_clk_mosi_on\0aud_dat_mosi_off\0aud_dat_mosi_on\0aud_dat_miso_off\0aud_dat_miso_on\0aud_smartpa_off\0aud_smartpa_on\0vow_dat_miso_off\0vow_dat_miso_on\0vow_clk_miso_off\0vow_clk_miso_on";
			status = "okay";
		};
	};

	fragment@27 {
		target = <0xffffffff>;

		__overlay__ {

			aud_clk_mosi_off {
				phandle = <0x1d>;

				pins_cmd0_dat {
					bias-pull-down;
					input-enable;
					pinmux = <0x8800>;
				};

				pins_cmd1_dat {
					bias-pull-down;
					input-enable;
					pinmux = <0x8900>;
				};
			};

			aud_clk_mosi_on {
				phandle = <0x1e>;

				pins_cmd0_dat {
					bias-disable;
					input-schmitt-enable;
					pinmux = <0x8801>;
				};

				pins_cmd1_dat {
					bias-disable;
					input-schmitt-enable;
					pinmux = <0x8901>;
				};
			};

			aud_dat_miso_off {
				phandle = <0x21>;

				pins_cmd0_dat {
					bias-disable;
					input-enable;
					pinmux = <0x8c00>;
				};

				pins_cmd1_dat {
					bias-disable;
					input-enable;
					pinmux = <0x8d00>;
				};

				pins_cmd2_dat {
					bias-disable;
					input-enable;
					pinmux = <0x8e00>;
				};

				pins_cmd3_dat {
					bias-disable;
					input-enable;
					pinmux = <0x8f00>;
				};
			};

			aud_dat_miso_on {
				phandle = <0x22>;

				pins_cmd0_dat {
					bias-disable;
					input-schmitt-enable;
					pinmux = <0x8c01>;
				};

				pins_cmd1_dat {
					bias-disable;
					input-schmitt-enable;
					pinmux = <0x8d01>;
				};

				pins_cmd2_dat {
					bias-disable;
					input-schmitt-enable;
					pinmux = <0x8e01>;
				};

				pins_cmd3_dat {
					bias-disable;
					input-schmitt-enable;
					pinmux = <0x8f01>;
				};
			};

			aud_dat_mosi_off {
				phandle = <0x1f>;

				pins_cmd0_dat {
					bias-disable;
					input-enable;
					pinmux = <0x8a00>;
				};

				pins_cmd1_dat {
					bias-pull-down;
					input-enable;
					pinmux = <0x8b00>;
				};
			};

			aud_dat_mosi_on {
				phandle = <0x20>;

				pins_cmd0_dat {
					bias-disable;
					input-schmitt-enable;
					pinmux = <0x8a01>;
				};

				pins_cmd1_dat {
					bias-disable;
					input-schmitt-enable;
					pinmux = <0x8b01>;
				};
			};

			aud_pins_smartpa_off {
				phandle = <0x23>;

				pins_cmd0_dat {
					pinmux = <0xae00>;
				};

				pins_cmd1_dat {
					pinmux = <0xaa00>;
				};

				pins_cmd2_dat {
					pinmux = <0xab00>;
				};

				pins_cmd3_dat {
					pinmux = <0xac00>;
				};
			};

			aud_pins_smartpa_on {
				phandle = <0x24>;

				pins_cmd0_dat {
					pinmux = <0xae02>;
				};

				pins_cmd1_dat {
					pinmux = <0xaa02>;
				};

				pins_cmd2_dat {
					pinmux = <0xab02>;
				};

				pins_cmd3_dat {
					pinmux = <0xac02>;
				};
			};

			vow_clk_miso_off {
				phandle = <0x27>;

				pins_cmd3_dat {
					bias-pull-down;
					input-enable;
					pinmux = <0x8f00>;
				};
			};

			vow_clk_miso_on {
				phandle = <0x28>;

				pins_cmd3_dat {
					bias-disable;
					input-schmitt-enable;
					pinmux = <0x8f04>;
				};
			};

			vow_dat_miso_off {
				phandle = <0x25>;

				pins_cmd1_dat {
					bias-pull-down;
					input-enable;
					pinmux = <0x8e00>;
				};
			};

			vow_dat_miso_on {
				phandle = <0x26>;

				pins_cmd1_dat {
					bias-disable;
					input-schmitt-enable;
					pinmux = <0x8e04>;
				};
			};
		};
	};

	fragment@28 {
		target = <0xffffffff>;

		__overlay__ {

			consys_default {
				phandle = <0x29>;
			};

			gpslna@0 {
				phandle = <0x2a>;

				pins_cmd_dat {
					bias-disable;
					output-low;
					pinmux = <0x9b00>;
					slew-rate = <0x00>;
				};
			};

			gpslna@1 {
				phandle = <0x2b>;

				pins_cmd_dat {
					output-high;
					pinmux = <0x9b00>;
					slew-rate = <0x01>;
				};
			};

			gpslna@2 {
				phandle = <0x2c>;

				pins_cmd_dat {
					output-low;
					pinmux = <0x9b00>;
					slew-rate = <0x01>;
				};
			};
		};
	};

	fragment@29 {
		target = <0xffffffff>;

		__overlay__ {
			pinctrl-0 = <0x29>;
			pinctrl-1 = <0x2a>;
			pinctrl-2 = <0x2b>;
			pinctrl-3 = <0x2c>;
			pinctrl-names = "default\0gps_lna_state_init\0gps_lna_state_oh\0gps_lna_state_ol";
			status = "okay";
		};
	};

	fragment@3 {
		target = <0xffffffff>;

		__overlay__ {
			direction = <0x06>;
			firlen = <0x00>;
			i2c_addr = <0x26 0x00 0x00 0x00>;
			i2c_num = <0x01>;
			is_batch_supported = <0x00>;
			power_id = <0xffff>;
			power_vol = <0x00>;
		};
	};

	fragment@30 {
		target = <0xffffffff>;

		__overlay__ {

			cam0@0 {
				phandle = <0x2e>;

				pins_cmd_dat {
					output-low;
					pinmux = <0x6500>;
					slew-rate = <0x01>;
				};
			};

			cam0@1 {
				phandle = <0x2f>;

				pins_cmd_dat {
					output-high;
					pinmux = <0x6500>;
					slew-rate = <0x01>;
				};
			};

			cam0@2 {
				phandle = <0x30>;

				pins_cmd_dat {
					output-low;
					pinmux = <0x6100>;
					slew-rate = <0x01>;
				};
			};

			cam0@3 {
				phandle = <0x31>;

				pins_cmd_dat {
					output-high;
					pinmux = <0x6100>;
					slew-rate = <0x01>;
				};
			};

			cam0@vcam0 {
				phandle = <0x3e>;

				pins_cmd_dat {
					output-low;
					pinmux = <0xa000>;
					slew-rate = <0x01>;
				};
			};

			cam0@vcam1 {
				phandle = <0x3f>;

				pins_cmd_dat {
					output-high;
					pinmux = <0xa000>;
					slew-rate = <0x01>;
				};
			};

			cam0@vcam2 {
				phandle = <0x40>;

				pins_cmd_dat {
					output-low;
					pinmux = <0x1100>;
					slew-rate = <0x01>;
				};
			};

			cam0@vcam3 {
				phandle = <0x41>;

				pins_cmd_dat {
					output-high;
					pinmux = <0x1100>;
					slew-rate = <0x01>;
				};
			};

			cam1@0 {
				phandle = <0x32>;

				pins_cmd_dat {
					output-low;
					pinmux = <0x6600>;
					slew-rate = <0x01>;
				};
			};

			cam1@1 {
				phandle = <0x33>;

				pins_cmd_dat {
					output-high;
					pinmux = <0x6600>;
					slew-rate = <0x01>;
				};
			};

			cam1@2 {
				phandle = <0x34>;

				pins_cmd_dat {
					output-low;
					pinmux = <0x6200>;
					slew-rate = <0x01>;
				};
			};

			cam1@3 {
				phandle = <0x35>;

				pins_cmd_dat {
					output-high;
					pinmux = <0x6200>;
					slew-rate = <0x01>;
				};
			};

			cam1@vcam0 {
				phandle = <0x42>;

				pins_cmd_dat {
					output-low;
					pinmux = <0x9d00>;
					slew-rate = <0x01>;
				};
			};

			cam1@vcam1 {
				phandle = <0x43>;

				pins_cmd_dat {
					output-high;
					pinmux = <0x9d00>;
					slew-rate = <0x01>;
				};
			};

			cam1@vcam2 {
				phandle = <0x44>;

				pins_cmd_dat {
					output-low;
					pinmux = <0x9c00>;
					slew-rate = <0x01>;
				};
			};

			cam1@vcam3 {
				phandle = <0x45>;

				pins_cmd_dat {
					output-high;
					pinmux = <0x9c00>;
					slew-rate = <0x01>;
				};
			};

			cam2@0 {
				phandle = <0x36>;

				pins_cmd_dat {
					output-low;
					pinmux = <0xd00>;
					slew-rate = <0x01>;
				};
			};

			cam2@1 {
				phandle = <0x37>;

				pins_cmd_dat {
					output-high;
					pinmux = <0xd00>;
					slew-rate = <0x01>;
				};
			};

			cam2@2 {
				phandle = <0x38>;

				pins_cmd_dat {
					output-low;
					pinmux = <0xe00>;
					slew-rate = <0x01>;
				};
			};

			cam2@3 {
				phandle = <0x39>;

				pins_cmd_dat {
					output-high;
					pinmux = <0xe00>;
					slew-rate = <0x01>;
				};
			};

			cam2@vcam0 {
				phandle = <0x46>;

				pins_cmd_dat {
					output-low;
					pinmux = <0x9e00>;
					slew-rate = <0x01>;
				};
			};

			cam2@vcam1 {
				phandle = <0x47>;

				pins_cmd_dat {
					output-high;
					pinmux = <0x9e00>;
					slew-rate = <0x01>;
				};
			};

			cam2@vcam2 {
				phandle = <0x48>;

				pins_cmd_dat {
					output-low;
					pinmux = <0x1100>;
					slew-rate = <0x01>;
				};
			};

			cam2@vcam3 {
				phandle = <0x49>;

				pins_cmd_dat {
					output-high;
					pinmux = <0x1100>;
					slew-rate = <0x01>;
				};
			};

			cam3@0 {
				phandle = <0x3a>;

				pins_cmd_dat {
					output-low;
					pinmux = <0x6d00>;
					slew-rate = <0x01>;
				};
			};

			cam3@1 {
				phandle = <0x3b>;

				pins_cmd_dat {
					output-high;
					pinmux = <0x6d00>;
					slew-rate = <0x01>;
				};
			};

			cam3@2 {
				phandle = <0x3c>;

				pins_cmd_dat {
					output-low;
					pinmux = <0x6b00>;
					slew-rate = <0x01>;
				};
			};

			cam3@3 {
				phandle = <0x3d>;

				pins_cmd_dat {
					output-high;
					pinmux = <0x6b00>;
					slew-rate = <0x01>;
				};
			};

			cam3@vcam0 {
				phandle = <0x4a>;

				pins_cmd_dat {
					output-low;
					pinmux = <0xa900>;
					slew-rate = <0x01>;
				};
			};

			cam3@vcam1 {
				phandle = <0x4b>;

				pins_cmd_dat {
					output-high;
					pinmux = <0xa900>;
					slew-rate = <0x01>;
				};
			};

			cam3@vcam2 {
				phandle = <0x4c>;

				pins_cmd_dat {
					output-low;
					pinmux = <0xa600>;
					slew-rate = <0x01>;
				};
			};

			cam3@vcam3 {
				phandle = <0x4d>;

				pins_cmd_dat {
					output-high;
					pinmux = <0xa600>;
					slew-rate = <0x01>;
				};
			};

			camdefault {
				phandle = <0x2d>;
			};

			camera_pins_cam0_mclk_2ma {
				phandle = <0x4f>;

				pins_cmd_dat {
					drive-strength = <0x00>;
					pinmux = <0x6301>;
				};
			};

			camera_pins_cam0_mclk_4ma {
				phandle = <0x50>;

				pins_cmd_dat {
					drive-strength = <0x01>;
					pinmux = <0x6301>;
				};
			};

			camera_pins_cam0_mclk_6ma {
				phandle = <0x51>;

				pins_cmd_dat {
					drive-strength = <0x02>;
					pinmux = <0x6301>;
				};
			};

			camera_pins_cam0_mclk_8ma {
				phandle = <0x52>;

				pins_cmd_dat {
					drive-strength = <0x03>;
					pinmux = <0x6301>;
				};
			};

			camera_pins_cam0_mclk_off {
				phandle = <0x4e>;

				pins_cmd_dat {
					drive-strength = <0x01>;
					pinmux = <0x6300>;
				};
			};

			camera_pins_cam1_mclk_2ma {
				phandle = <0x54>;

				pins_cmd_dat {
					drive-strength = <0x00>;
					pinmux = <0x6401>;
				};
			};

			camera_pins_cam1_mclk_4ma {
				phandle = <0x55>;

				pins_cmd_dat {
					drive-strength = <0x01>;
					pinmux = <0x6401>;
				};
			};

			camera_pins_cam1_mclk_6ma {
				phandle = <0x56>;

				pins_cmd_dat {
					drive-strength = <0x02>;
					pinmux = <0x6401>;
				};
			};

			camera_pins_cam1_mclk_8ma {
				phandle = <0x57>;

				pins_cmd_dat {
					drive-strength = <0x03>;
					pinmux = <0x6401>;
				};
			};

			camera_pins_cam1_mclk_off {
				phandle = <0x53>;

				pins_cmd_dat {
					drive-strength = <0x01>;
					pinmux = <0x6400>;
				};
			};

			camera_pins_cam2_mclk_2ma {
				phandle = <0x59>;

				pins_cmd_dat {
					drive-strength = <0x00>;
					pinmux = <0x6401>;
				};
			};

			camera_pins_cam2_mclk_4ma {
				phandle = <0x5a>;

				pins_cmd_dat {
					drive-strength = <0x01>;
					pinmux = <0x6401>;
				};
			};

			camera_pins_cam2_mclk_6ma {
				phandle = <0x5b>;

				pins_cmd_dat {
					drive-strength = <0x02>;
					pinmux = <0x6401>;
				};
			};

			camera_pins_cam2_mclk_8ma {
				phandle = <0x5c>;

				pins_cmd_dat {
					drive-strength = <0x03>;
					pinmux = <0x6401>;
				};
			};

			camera_pins_cam2_mclk_off {
				phandle = <0x58>;

				pins_cmd_dat {
					drive-strength = <0x01>;
					pinmux = <0x6400>;
				};
			};

			camera_pins_cam3_mclk_2ma {
				phandle = <0x5e>;

				pins_cmd_dat {
					drive-strength = <0x00>;
					pinmux = <0x6c01>;
				};
			};

			camera_pins_cam3_mclk_4ma {
				phandle = <0x5f>;

				pins_cmd_dat {
					drive-strength = <0x01>;
					pinmux = <0x6c01>;
				};
			};

			camera_pins_cam3_mclk_6ma {
				phandle = <0x60>;

				pins_cmd_dat {
					drive-strength = <0x02>;
					pinmux = <0x6c01>;
				};
			};

			camera_pins_cam3_mclk_8ma {
				phandle = <0x61>;

				pins_cmd_dat {
					drive-strength = <0x03>;
					pinmux = <0x6c01>;
				};
			};

			camera_pins_cam3_mclk_off {
				phandle = <0x5d>;

				pins_cmd_dat {
					drive-strength = <0x01>;
					pinmux = <0x6c00>;
				};
			};

			mipiswitchen@0 {
				phandle = <0x62>;

				pins_cmd_dat {
					output-low;
					pinmux = <0xaf00>;
					slew-rate = <0x01>;
				};
			};

			mipiswitchen@1 {
				phandle = <0x63>;

				pins_cmd_dat {
					output-high;
					pinmux = <0xaf00>;
					slew-rate = <0x01>;
				};
			};

			mipiswitchsel@0 {
				phandle = <0x64>;

				pins_cmd_dat {
					output-low;
					pinmux = <0xb200>;
					slew-rate = <0x01>;
				};
			};

			mipiswitchsel@1 {
				phandle = <0x65>;

				pins_cmd_dat {
					output-high;
					pinmux = <0xb200>;
					slew-rate = <0x01>;
				};
			};
		};
	};

	fragment@31 {
		target = <0xffffffff>;

		__overlay__ {
			cam0_vcama-supply = <0xffffffff>;
			cam0_vcamaf-supply = <0xffffffff>;
			cam0_vcamio-supply = <0xffffffff>;
			cam1_vcama-supply = <0xffffffff>;
			cam1_vcamd-supply = <0xffffffff>;
			cam1_vcamio-supply = <0xffffffff>;
			cam2_vcamaf-supply = <0xffffffff>;
			cam2_vcamio-supply = <0xffffffff>;
			cam3_vcamio-supply = <0xffffffff>;
			pinctrl-0 = <0x2d>;
			pinctrl-1 = <0x2e>;
			pinctrl-10 = <0x37>;
			pinctrl-11 = <0x38>;
			pinctrl-12 = <0x39>;
			pinctrl-13 = <0x3a>;
			pinctrl-14 = <0x3b>;
			pinctrl-15 = <0x3c>;
			pinctrl-16 = <0x3d>;
			pinctrl-17 = <0x3e>;
			pinctrl-18 = <0x3f>;
			pinctrl-19 = <0x40>;
			pinctrl-2 = <0x2f>;
			pinctrl-20 = <0x41>;
			pinctrl-21 = <0x42>;
			pinctrl-22 = <0x43>;
			pinctrl-23 = <0x44>;
			pinctrl-24 = <0x45>;
			pinctrl-25 = <0x46>;
			pinctrl-26 = <0x47>;
			pinctrl-27 = <0x48>;
			pinctrl-28 = <0x49>;
			pinctrl-29 = <0x4a>;
			pinctrl-3 = <0x30>;
			pinctrl-30 = <0x4b>;
			pinctrl-31 = <0x4c>;
			pinctrl-32 = <0x4d>;
			pinctrl-33 = <0x4e>;
			pinctrl-34 = <0x4f>;
			pinctrl-35 = <0x50>;
			pinctrl-36 = <0x51>;
			pinctrl-37 = <0x52>;
			pinctrl-38 = <0x53>;
			pinctrl-39 = <0x54>;
			pinctrl-4 = <0x31>;
			pinctrl-40 = <0x55>;
			pinctrl-41 = <0x56>;
			pinctrl-42 = <0x57>;
			pinctrl-43 = <0x58>;
			pinctrl-44 = <0x59>;
			pinctrl-45 = <0x5a>;
			pinctrl-46 = <0x5b>;
			pinctrl-47 = <0x5c>;
			pinctrl-48 = <0x5d>;
			pinctrl-49 = <0x5e>;
			pinctrl-5 = <0x32>;
			pinctrl-50 = <0x5f>;
			pinctrl-51 = <0x60>;
			pinctrl-52 = <0x61>;
			pinctrl-53 = <0x62>;
			pinctrl-54 = <0x63>;
			pinctrl-55 = <0x64>;
			pinctrl-56 = <0x65>;
			pinctrl-6 = <0x33>;
			pinctrl-7 = <0x34>;
			pinctrl-8 = <0x35>;
			pinctrl-9 = <0x36>;
			pinctrl-names = "default\0cam0_rst0\0cam0_rst1\0cam0_pnd0\0cam0_pnd1\0cam1_rst0\0cam1_rst1\0cam1_pnd0\0cam1_pnd1\0cam2_rst0\0cam2_rst1\0cam2_pnd0\0cam2_pnd1\0cam3_rst0\0cam3_rst1\0cam3_pnd0\0cam3_pnd1\0cam0_ldo_vcamd_0\0cam0_ldo_vcamd_1\0cam0_ldo_vcama_0\0cam0_ldo_vcama_1\0cam1_ldo_vcamd_0\0cam1_ldo_vcamd_1\0cam1_ldo_vcama_0\0cam1_ldo_vcama_1\0cam2_ldo_vcamd_0\0cam2_ldo_vcamd_1\0cam2_ldo_vcama_0\0cam2_ldo_vcama_1\0cam3_ldo_vcamd_0\0cam3_ldo_vcamd_1\0cam3_ldo_vcama_0\0cam3_ldo_vcama_1\0cam0_mclk_off\0cam0_mclk_2mA\0cam0_mclk_4mA\0cam0_mclk_6mA\0cam0_mclk_8mA\0cam1_mclk_off\0cam1_mclk_2mA\0cam1_mclk_4mA\0cam1_mclk_6mA\0cam1_mclk_8mA\0cam2_mclk_off\0cam2_mclk_2mA\0cam2_mclk_4mA\0cam2_mclk_6mA\0cam2_mclk_8mA\0cam3_mclk_off\0cam3_mclk_2mA\0cam3_mclk_4mA\0cam3_mclk_6mA\0cam3_mclk_8mA\0cam_mipi_switch_en_0\0cam_mipi_switch_en_1\0cam_mipi_switch_sel_0\0cam_mipi_switch_sel_1";
			status = "okay";
		};
	};

	fragment@32 {
		target = <0xffffffff>;

		__overlay__ {
			pinctrl-0 = <0x66>;
			pinctrl-1 = <0x67>;
			pinctrl-names = "irtx_gpio_led_default\0irtx_gpio_led_set";
			status = "okay";
		};
	};

	fragment@33 {
		target = <0xffffffff>;

		__overlay__ {

			irtx_gpio_led_def@gpio90 {
				phandle = <0x66>;

				pins_cmd_dat {
					bias-disable;
					input-schmitt-enable = <0x00>;
					output-low;
					pinmux = <0x5a00>;
					slew-rate = <0x01>;
				};
			};

			irtx_gpio_led_set@gpio90 {
				phandle = <0x67>;

				pins_cmd_dat {
					output-high;
					pinmux = <0x5a01>;
					slew-rate = <0x01>;
				};
			};
		};
	};

	fragment@34 {
		target = <0xffffffff>;

		__overlay__ {
			mt6370,intr_gpio = <0xffffffff 0x0a 0x00>;
			mt6370,intr_gpio_num = <0x0a>;
		};
	};

	fragment@35 {
		target = <0xffffffff>;

		__overlay__ {
			mt6370pd,intr_gpio = <0xffffffff 0x29 0x00>;
			mt6370pd,intr_gpio_num = <0x29>;
		};
	};

	fragment@36 {
		target = <0xffffffff>;

		__overlay__ {

			c1_high {
				phandle = <0x05>;

				pins_cmd_dat {
					output-high;
					pinmux = <0x1200>;
					slew-rate = <0x01>;
				};
			};

			c1_highz {
				phandle = <0x04>;

				pins_cmd_dat {
					bias-disable;
					pinmux = <0x1200>;
					slew-rate = <0x00>;
				};
			};

			c1_init {
				phandle = <0x02>;

				pins_cmd_dat {
					output-low;
					pinmux = <0x1200>;
					slew-rate = <0x01>;
				};
			};

			c1_low {
				phandle = <0x03>;

				pins_cmd_dat {
					output-low;
					pinmux = <0x1200>;
					slew-rate = <0x01>;
				};
			};

			c2_high {
				phandle = <0x09>;

				pins_cmd_dat {
					output-high;
					pinmux = <0x1100>;
					slew-rate = <0x01>;
				};
			};

			c2_highz {
				phandle = <0x08>;

				pins_cmd_dat {
					bias-disable;
					pinmux = <0x1100>;
					slew-rate = <0x00>;
				};
			};

			c2_init {
				phandle = <0x06>;

				pins_cmd_dat {
					output-low;
					pinmux = <0x1100>;
					slew-rate = <0x01>;
				};
			};

			c2_low {
				phandle = <0x07>;

				pins_cmd_dat {
					output-low;
					pinmux = <0x1100>;
					slew-rate = <0x01>;
				};
			};

			u3_sw_dis {
				phandle = <0x0d>;
			};

			u3_sw_en {
				phandle = <0x0c>;
			};

			u3_sw_sel1 {
				phandle = <0x0a>;

				pins_cmd_dat {
					output-low;
					pinmux = <0xb100>;
					slew-rate = <0x01>;
				};
			};

			u3_sw_sel2 {
				phandle = <0x0b>;

				pins_cmd_dat {
					output-high;
					pinmux = <0xb100>;
					slew-rate = <0x01>;
				};
			};

			usb_default {
				phandle = <0x01>;
			};
		};
	};

	fragment@37 {
		target = <0xffffffff>;

		__overlay__ {
			ac_charger_current = <0x1dc130>;
			algorithm_name = "SwitchCharging";
		};
	};

	fragment@38 {
		target = <0xffffffff>;

		__overlay__ {

			cap_touch_ili9882n@41 {
				compatible = "mediatek,cap_touch_ili9882n";
				reg = <0x41>;
			};
		};
	};

	fragment@39 {
		target = <0xffffffff>;

		__overlay__ {

			alsps_ltr559@23 {
				compatible = "mediatek,alsps_ltr559";
				reg = <0x23>;
				status = "okay";
			};

			alsps_stk3332_auto@47 {
				compatible = "mediatek,alsps_stk3332_auto";
				reg = <0x47>;
				status = "okay";
			};

			alsps_stk3332sv_auto@77 {
				compatible = "mediatek,alsps_stk3332sv_auto";
				reg = <0x77>;
				status = "okay";
			};

			alsps_stk3x1x_auto@48 {
				compatible = "mediatek,alsps_stk3x1x_auto";
				reg = <0x48>;
				status = "okay";
			};

			alsps_stk3x3x_auto@67 {
				compatible = "mediatek,alsps_stk3x3x_auto";
				reg = <0x67>;
				status = "okay";
			};

			gsensor_bmi160@68 {
				compatible = "mediatek,gsensor_bmi160";
				reg = <0x68>;
				status = "okay";
			};

			gsensor_gsensor_sc7a20@19 {
				compatible = "mediatek,gsensor_sc7a20";
				reg = <0x19>;
				status = "okay";
			};

			gsensor_icm426xx@65 {
				compatible = "mediatek,gsensor_icm426xx";
				reg = <0x65>;
				status = "okay";
			};

			gsensor_mir3da@26 {
				compatible = "mediatek,gsensor_mir3da";
				reg = <0x26>;
				status = "okay";
			};

			gsensor_mxc6655@15 {
				compatible = "mediatek,gsensor_mxc6655";
				reg = <0x15>;
				status = "okay";
			};

			gsensor_stk832x_auto@0F {
				compatible = "mediatek,gsensor_stk832x_auto";
				reg = <0x0f>;
				status = "okay";
			};

			gyro_bmi160@69 {
				compatible = "mediatek,gyro_bmi160";
				reg = <0x69>;
				status = "okay";
			};

			gyro_icm426xx@66 {
				compatible = "mediatek,gyro_icm426xx";
				reg = <0x66>;
				status = "okay";
			};

			mag_mmc5603x@30 {
				compatible = "mediatek,mag_mmc5603x";
				reg = <0x30>;
				status = "okay";
			};
		};
	};

	fragment@4 {
		target = <0xffffffff>;

		__overlay__ {
			direction = <0x05>;
			firlen = <0x00>;
			i2c_addr = <0x65 0x00 0x00 0x00>;
			i2c_num = <0x01>;
			is_batch_supported = <0x00>;
			power_id = <0xffff>;
			power_vol = <0x00>;
		};
	};

	fragment@40 {
		target = <0xffffffff>;

		__overlay__ {

			aw87339@58 {
				compatible = "awinic,aw87339_pa";
				reg = <0x58>;
				reset-gpio = <0xffffffff 0x99 0x00>;
				status = "okay";
			};

			temp_fm78100@44 {
				compatible = "mediatek,temp_fm78100";
				reg = <0x44>;
				status = "okay";
			};
		};
	};

	fragment@41 {
		target = <0xffffffff>;

		__overlay__ {

			rt9465@4b {
				charger_name = "secondary_chg";
				compatible = "richtek,rt9465";
				cv = <0x456d70>;
				en_st;
				en_wdt;
				ichg = <0x16e360>;
				ieoc = <0xaae60>;
				interrupt-names = "wdtmri";
				mivr = <0x44aa20>;
				reg = <0x4b>;
				rt,en_gpio = <0xffffffff 0xb3 0x00>;
				rt,en_gpio_num = <0xb3>;
				rt,intr_gpio = <0xffffffff 0x09 0x00>;
				rt,intr_gpio_num = <0x09>;
				safety_timer = <0x0c>;
				status = "okay";
			};
		};
	};

	fragment@42 {
		target = <0xffffffff>;

		__overlay__ {

			i2c_scl1_pio {
				phandle = <0x6d>;

				pins_cmd_dat {
					drive-strength = <0x03>;
					pinmux = <0x5401>;
				};
			};

			i2c_sda1_pio {
				phandle = <0x6c>;

				pins_cmd_dat {
					drive-strength = <0x03>;
					pinmux = <0x5101>;
				};
			};

			tempdefaultcfg {
				phandle = <0x68>;
			};

			tempen@0 {
				phandle = <0x6a>;

				pins_cmd_dat {
					output-low;
					pinmux = <0x1400>;
					slew-rate = <0x01>;
				};
			};

			tempen@1 {
				phandle = <0x6b>;

				pins_cmd_dat {
					output-high;
					pinmux = <0x1400>;
					slew-rate = <0x01>;
				};
			};

			temppincfg {
				phandle = <0x69>;

				pins_cmd_dat {
					bias-pull-down = <0x00>;
					pinmux = <0x1500>;
					slew-rate = <0x00>;
				};
			};
		};
	};

	fragment@43 {
		target = <0xffffffff>;

		__overlay__ {
			pinctrl-0 = <0x68>;
			pinctrl-1 = <0x69>;
			pinctrl-2 = <0x6a>;
			pinctrl-3 = <0x6b>;
			pinctrl-4 = <0x6c>;
			pinctrl-5 = <0x6d>;
			pinctrl-names = "pin_default\0pin_cfg\0pin_en_low\0pin_en_high\0i2c_sda1_pio\0i2c_scl1_pio";
			status = "okay";
		};
	};

	fragment@44 {
		target = <0xffffffff>;

		__overlay__ {
			#address-cells = <0x01>;
			#size-cells = <0x00>;

			fingerprint-spi@ {
				compatible = "mediatek,finger-spi";
				reg = <0x00>;
				spi-max-frequency = <0x10000000>;
				status = "okay";
			};
		};
	};

	fragment@45 {
		target = <0xffffffff>;

		__overlay__ {
			#address-cells = <0x01>;
			#size-cells = <0x00>;

			fingerprint-spi2@ {
				compatible = "mediatek,finger-spi2";
				reg = <0x01>;
				spi-max-frequency = <0x10000000>;
				status = "okay";
			};
		};
	};

	fragment@46 {
		target = <0xffffffff>;

		__overlay__ {

			fp_int_def {
				phandle = <0x71>;

				pins_cmd_dat {
					bias-pull-down = <0x00>;
					pinmux = <0x800>;
					slew-rate = <0x00>;
				};
			};

			fp_power_2v8_high {
				phandle = <0x72>;

				pins_cmd_dat {
					output-high;
					pinmux = <0xb000>;
					slew-rate = <0x01>;
				};
			};

			fp_power_2v8_low {
				phandle = <0x73>;

				pins_cmd_dat {
					output-low;
					pinmux = <0xb000>;
					slew-rate = <0x01>;
				};
			};

			fp_rst_high {
				phandle = <0x6f>;

				pins_cmd_dat {
					output-high;
					pinmux = <0xb100>;
					slew-rate = <0x01>;
				};
			};

			fp_rst_low {
				phandle = <0x70>;

				pins_cmd_dat {
					output-low;
					pinmux = <0xb100>;
					slew-rate = <0x01>;
				};
			};

			fp_spi {
				phandle = <0x6e>;

				pins_cmd2_dat {
					bias-pull-up = <0x0b>;
					output_low;
					pinmux = <0x5501>;
					slew-rate = <0x00>;
				};

				pins_cmd3_dat {
					bias-pull-up = <0x0b>;
					output_low;
					pinmux = <0x5701>;
					slew-rate = <0x01>;
				};

				pins_cmd4_dat {
					bias-pull-up = <0x0b>;
					output_low;
					pinmux = <0x5601>;
					slew-rate = <0x01>;
				};

				pins_cmd_dat {
					bias-pull-up = <0x0b>;
					output_low;
					pinmux = <0x5801>;
					slew-rate = <0x01>;
				};
			};
		};
	};

	fragment@47 {
		target = <0xffffffff>;

		__overlay__ {
			fpint-gpio = <0xffffffff 0x08 0x00>;
			fppower-gpio = <0xffffffff 0xb0 0x00>;
			fpreset-gpio = <0xffffffff 0xb1 0x00>;
			interrupt-parent = <0xffffffff>;
			interrupts = <0x08 0x08 0x08 0x00>;
			pinctrl-0 = <0x6e>;
			pinctrl-1 = <0x6f>;
			pinctrl-2 = <0x70>;
			pinctrl-3 = <0x71>;
			pinctrl-4 = <0x72>;
			pinctrl-5 = <0x73>;
			pinctrl-names = "spi_default\0finger_reset_en1\0finger_reset_en0\0finger_int_as_int\0finger_power_en1\0finger_power_en0";
			status = "okay";
		};
	};

	fragment@48 {
		target = <0xffffffff>;

		__overlay__ {
			pinctrl-0 = <0x74>;
			pinctrl-1 = <0x75>;
			pinctrl-2 = <0x76>;
			pinctrl-3 = <0x77>;
			pinctrl-names = "default\0lcm_rst\0lcm_rst_gpio_high\0lcm_rst_gpio_low";
			status = "okay";
		};
	};

	fragment@49 {
		target = <0xffffffff>;

		__overlay__ {

			lcm_rst_gpio_mode1@gpio45 {
				phandle = <0x75>;

				pins_cmd_dat {
					pinmux = <0x2d01>;
				};
			};

			lcm_rst_gpio_mode2@gpio45 {
				phandle = <0x76>;

				pins_cmd_dat {
					output-high;
					pinmux = <0x2d00>;
					slew-rate = <0x01>;
				};
			};

			lcm_rst_gpio_mode3@gpio45 {
				phandle = <0x77>;

				pins_cmd_dat {
					output-low;
					pinmux = <0x2d00>;
					slew-rate = <0x01>;
				};
			};

			lcmrstdefault {
				phandle = <0x74>;
			};
		};
	};

	fragment@5 {
		target = <0xffffffff>;

		__overlay__ {
			direction = <0x03>;
			firlen = <0x00>;
			i2c_addr = <0x15 0x00 0x00 0x00>;
			i2c_num = <0x01>;
			is_batch_supported = <0x00>;
			power_id = <0xffff>;
			power_vol = <0x00>;
		};
	};

	fragment@50 {
		target = <0xffffffff>;

		__overlay__ {

			lcd_bias_enp0_gpio {
				phandle = <0x7d>;

				pins_cmd_dat {
					output-low;
					pinmux = <0x1700>;
					slew-rate = <0x01>;
				};
			};

			lcd_bias_enp1_gpio {
				phandle = <0x7e>;

				pins_cmd_dat {
					output-high;
					pinmux = <0x1700>;
					slew-rate = <0x01>;
				};
			};

			lcm_rst_out0_gpio {
				phandle = <0x7b>;

				pins_cmd_dat {
					output-low;
					pinmux = <0x2d01>;
					slew-rate = <0x01>;
				};
			};

			lcm_rst_out1_gpio {
				phandle = <0x7c>;

				pins_cmd_dat {
					output-high;
					pinmux = <0x2d01>;
					slew-rate = <0x01>;
				};
			};

			mode_te_gpio {
				phandle = <0x79>;

				pins_cmd_dat {
					pinmux = <0x2c00>;
				};
			};

			mode_te_te {
				phandle = <0x7a>;

				pins_cmd_dat {
					pinmux = <0x2c01>;
				};
			};

			mtkfb_default {
				phandle = <0x78>;
			};
		};
	};

	fragment@51 {
		target = <0xffffffff>;

		__overlay__ {
			partial-update = <0x00>;
			pinctrl-0 = <0x78>;
			pinctrl-1 = <0x79>;
			pinctrl-2 = <0x7a>;
			pinctrl-3 = <0x7b>;
			pinctrl-4 = <0x7c>;
			pinctrl-5 = <0x7d>;
			pinctrl-6 = <0x7e>;
			pinctrl-names = "default\0mode_te_gpio\0mode_te_te\0lcm_rst_out0_gpio\0lcm_rst_out1_gpio\0lcd_bias_enp0_gpio\0lcd_bias_enp1_gpio";
			status = "okay";
		};
	};

	fragment@52 {
		target = <0xffffffff>;

		__overlay__ {

			adc_channel@ {
				compatible = "mediatek,adc_channel";
				mediatek,adc_fdd_rf_params_dynamic_custom_ch = <0x02>;
				mediatek,temperature0 = <0x00>;
				mediatek,temperature1 = <0x01>;
				status = "okay";
			};
		};
	};

	fragment@53 {
		target = <0xffffffff>;

		__overlay__ {
			io-channels = <0xffffffff 0x02>;
		};
	};

	fragment@54 {
		target = <0xffffffff>;

		__overlay__ {
			mediatek,clkbuf-config = <0x02 0x01 0x01 0x02 0x00 0x00 0x01>;
			mediatek,clkbuf-driving-current = <0xffffffff 0xffffffff 0xffffffff 0xffffffff 0xffffffff 0xffffffff 0xffffffff>;
			mediatek,clkbuf-quantity = <0x07>;
			status = "okay";
		};
	};

	fragment@55 {
		target = <0xffffffff>;

		__overlay__ {
			#address-cells = <0x01>;
			#size-cells = <0x00>;
			clock-frequency = <0x61a80>;
			mediatek,use-open-drain;

			cap_touch@5d {
				compatible = "mediatek,cap_touch";
				phandle = <0x88>;
				reg = <0x5d>;
				status = "okay";
			};
		};
	};

	fragment@56 {
		target = <0xffffffff>;

		__overlay__ {
			#address-cells = <0x01>;
			#size-cells = <0x00>;
			clock-frequency = <0x493e0>;
			mediatek,use-open-drain;

			alsps@51 {
				compatible = "mediatek,alsps";
				phandle = <0x8a>;
				reg = <0x51>;
				status = "okay";
			};

			barometer@77 {
				compatible = "mediatek,barometer";
				phandle = <0x8b>;
				reg = <0x77>;
				status = "okay";
			};

			msensor@0c {
				compatible = "mediatek,msensor";
				phandle = <0x89>;
				reg = <0x0c>;
				status = "okay";
			};
		};
	};

	fragment@57 {
		target = <0xffffffff>;

		__overlay__ {
			#address-cells = <0x01>;
			#size-cells = <0x00>;
			clock-frequency = <0x61a80>;
			mediatek,use-open-drain;

			camera_main@1a {
				compatible = "mediatek,camera_main";
				phandle = <0x8c>;
				reg = <0x1a>;
				status = "okay";
			};

			camera_main_af@72 {
				compatible = "mediatek,camera_main_af";
				phandle = <0x8d>;
				reg = <0x72>;
				status = "okay";
			};

			camera_main_eeprom@50 {
				compatible = "mediatek,camera_main_eeprom";
				phandle = <0x8e>;
				reg = <0x50>;
				status = "okay";
			};

			ccu_sensor_i2c_main_hw@33 {
				compatible = "mediatek,ccu_sensor_i2c_main_hw";
				phandle = <0x8f>;
				reg = <0x33>;
				status = "okay";
			};
		};
	};

	fragment@58 {
		target = <0xffffffff>;

		__overlay__ {
			#address-cells = <0x01>;
			#size-cells = <0x00>;
			clock-frequency = <0x61a80>;
			mediatek,use-open-drain;

			nfc@08 {
				compatible = "mediatek,nfc";
				phandle = <0x90>;
				reg = <0x08>;
				status = "okay";
			};
		};
	};

	fragment@59 {
		target = <0xffffffff>;

		__overlay__ {
			#address-cells = <0x01>;
			#size-cells = <0x00>;
			clock-frequency = <0x61a80>;
			mediatek,use-open-drain;

			camera_main_two_af@72 {
				compatible = "mediatek,camera_main_two_af";
				phandle = <0x91>;
				reg = <0x72>;
				status = "okay";
			};

			camera_sub@35 {
				compatible = "mediatek,camera_sub";
				phandle = <0x92>;
				reg = <0x35>;
				status = "okay";
			};

			camera_sub_eeprom@54 {
				compatible = "mediatek,camera_sub_eeprom";
				phandle = <0x93>;
				reg = <0x54>;
				status = "okay";
			};

			ccu_sensor_i2c_main3_hw@11 {
				compatible = "mediatek,ccu_sensor_i2c_main3_hw";
				phandle = <0x95>;
				reg = <0x11>;
				status = "okay";
			};

			ccu_sensor_i2c_sub_hw@43 {
				compatible = "mediatek,ccu_sensor_i2c_sub_hw";
				phandle = <0x94>;
				reg = <0x43>;
				status = "okay";
			};
		};
	};

	fragment@6 {
		target = <0xffffffff>;

		__overlay__ {
			direction = <0x03>;
			firlen = <0x00>;
			i2c_addr = <0x19 0x00 0x00 0x00>;
			i2c_num = <0x01>;
			is_batch_supported = <0x00>;
			power_id = <0xffff>;
			power_vol = <0x00>;
		};
	};

	fragment@60 {
		target = <0xffffffff>;

		__overlay__ {
			#address-cells = <0x01>;
			#size-cells = <0x00>;
			clock-frequency = <0x33e140>;
			mediatek,use-push-pull;

			subpmic_pmu@34 {
				compatible = "mediatek,subpmic_pmu";
				phandle = <0x97>;
				reg = <0x34>;
				status = "okay";
			};

			usb_type_c@4e {
				compatible = "mediatek,usb_type_c";
				phandle = <0x96>;
				reg = <0x4e>;
				status = "okay";
			};
		};
	};

	fragment@61 {
		target = <0xffffffff>;

		__overlay__ {
			#address-cells = <0x01>;
			#size-cells = <0x00>;
			clock-frequency = <0x61a80>;
			mediatek,use-open-drain;

			camera_main_two@10 {
				compatible = "mediatek,camera_main_two";
				phandle = <0x98>;
				reg = <0x10>;
				status = "okay";
			};

			camera_main_two_eeprom@51 {
				compatible = "mediatek,camera_main_two_eeprom";
				phandle = <0x99>;
				reg = <0x51>;
				status = "okay";
			};

			ccu_sensor_i2c_main2_hw@36 {
				compatible = "mediatek,ccu_sensor_i2c_main2_hw";
				phandle = <0x9c>;
				reg = <0x36>;
				status = "okay";
			};

			slave_charger@4b {
				compatible = "mediatek,slave_charger";
				phandle = <0x9b>;
				reg = <0x4b>;
				status = "okay";
			};

			speaker_amp@34 {
				compatible = "mediatek,speaker_amp";
				phandle = <0x9a>;
				reg = <0x34>;
				status = "okay";
			};
		};
	};

	fragment@62 {
		target = <0xffffffff>;

		__overlay__ {
			#address-cells = <0x01>;
			#size-cells = <0x00>;
			clock-frequency = <0x61a80>;
			mediatek,use-open-drain;
		};
	};

	fragment@63 {
		target = <0xffffffff>;

		__overlay__ {
			#address-cells = <0x01>;
			#size-cells = <0x00>;
			clock-frequency = <0x61a80>;
			mediatek,use-open-drain;
		};
	};

	fragment@64 {
		target = <0xffffffff>;

		__overlay__ {
			#address-cells = <0x01>;
			#size-cells = <0x00>;
			clock-frequency = <0x61a80>;
			mediatek,use-open-drain;
		};
	};

	fragment@65 {
		target = <0xffffffff>;

		__overlay__ {
			#address-cells = <0x01>;
			#size-cells = <0x00>;
			clock-frequency = <0x61a80>;
			mediatek,use-open-drain;
		};
	};

	fragment@66 {
		target = <0xffffffff>;

		__overlay__ {
			#address-cells = <0x01>;
			#size-cells = <0x00>;
			clock-frequency = <0x61a80>;
			mediatek,use-open-drain;
		};
	};

	fragment@67 {
		target = <0xffffffff>;

		__overlay__ {
			GPIO_SIM1_HOT_PLUG = <0xffffffff 0x2f 0x00>;
			GPIO_SIM1_SCLK = <0xffffffff 0x26 0x00>;
			GPIO_SIM1_SIO = <0xffffffff 0x28 0x00>;
			GPIO_SIM1_SRST = <0xffffffff 0x27 0x00>;
			GPIO_SIM2_HOT_PLUG = <0xffffffff 0x2e 0x00>;
			GPIO_SIM2_SCLK = <0xffffffff 0x25 0x00>;
			GPIO_SIM2_SIO = <0xffffffff 0x23 0x00>;
			GPIO_SIM2_SRST = <0xffffffff 0x24 0x00>;
		};
	};

	fragment@68 {
		target = <0xffffffff>;

		__overlay__ {
			gpio_init_default = <0x00 0x00 0x00 0x00 0x01 0x01 0x01 0x01 0x00 0x00 0x00 0x01 0x01 0x01 0x02 0x00 0x01 0x00 0x00 0x00 0x01 0x03 0x00 0x00 0x00 0x01 0x01 0x01 0x04 0x00 0x00 0x00 0x01 0x01 0x00 0x05 0x00 0x00 0x00 0x01 0x01 0x00 0x06 0x00 0x00 0x00 0x01 0x01 0x00 0x07 0x00 0x00 0x00 0x01 0x01 0x00 0x08 0x00 0x00 0x00 0x01 0x01 0x00 0x09 0x00 0x00 0x00 0x01 0x01 0x00 0x0a 0x00 0x00 0x00 0x01 0x01 0x00 0x0b 0x03 0x00 0x00 0x01 0x01 0x00 0x0c 0x03 0x00 0x00 0x01 0x01 0x00 0x0d 0x00 0x01 0x00 0x00 0x00 0x00 0x0e 0x00 0x01 0x00 0x00 0x00 0x00 0x0f 0x02 0x01 0x00 0x01 0x00 0x00 0x10 0x02 0x01 0x00 0x00 0x00 0x00 0x11 0x00 0x01 0x00 0x00 0x00 0x00 0x12 0x00 0x01 0x01 0x00 0x00 0x00 0x13 0x00 0x00 0x00 0x01 0x01 0x00 0x14 0x00 0x01 0x00 0x00 0x00 0x00 0x15 0x00 0x00 0x00 0x01 0x00 0x00 0x16 0x04 0x00 0x00 0x01 0x00 0x00 0x17 0x00 0x00 0x00 0x01 0x00 0x00 0x18 0x00 0x01 0x00 0x00 0x00 0x00 0x19 0x05 0x00 0x00 0x01 0x00 0x00 0x1a 0x00 0x00 0x00 0x01 0x01 0x00 0x1b 0x05 0x01 0x00 0x00 0x00 0x00 0x1c 0x05 0x00 0x00 0x01 0x01 0x00 0x1d 0x01 0x01 0x00 0x00 0x00 0x00 0x1e 0x01 0x00 0x00 0x01 0x01 0x00 0x1f 0x01 0x00 0x00 0x01 0x01 0x00 0x20 0x01 0x00 0x00 0x01 0x01 0x00 0x21 0x01 0x00 0x00 0x01 0x01 0x00 0x22 0x01 0x00 0x00 0x01 0x01 0x00 0x23 0x01 0x00 0x00 0x01 0x01 0x00 0x24 0x01 0x01 0x00 0x00 0x00 0x00 0x25 0x01 0x01 0x00 0x00 0x00 0x00 0x26 0x01 0x01 0x00 0x00 0x00 0x00 0x27 0x01 0x01 0x00 0x00 0x00 0x00 0x28 0x01 0x00 0x00 0x01 0x01 0x00 0x29 0x00 0x00 0x00 0x01 0x01 0x00 0x2a 0x00 0x01 0x00 0x00 0x00 0x00 0x2b 0x01 0x01 0x00 0x00 0x00 0x00 0x2c 0x01 0x00 0x00 0x01 0x00 0x00 0x2d 0x01 0x01 0x00 0x00 0x00 0x00 0x2e 0x01 0x00 0x00 0x01 0x01 0x00 0x2f 0x01 0x00 0x00 0x01 0x01 0x00 0x30 0x01 0x00 0x00 0x01 0x01 0x00 0x31 0x01 0x00 0x00 0x01 0x01 0x00 0x32 0x01 0x00 0x00 0x01 0x01 0x00 0x33 0x01 0x00 0x00 0x01 0x01 0x00 0x34 0x01 0x01 0x00 0x01 0x00 0x00 0x35 0x01 0x01 0x00 0x01 0x00 0x00 0x36 0x01 0x01 0x00 0x01 0x00 0x00 0x37 0x01 0x01 0x00 0x01 0x00 0x00 0x38 0x01 0x01 0x00 0x01 0x00 0x00 0x39 0x01 0x01 0x00 0x01 0x00 0x00 0x3a 0x00 0x00 0x00 0x01 0x00 0x00 0x3b 0x01 0x00 0x00 0x01 0x00 0x00 0x3c 0x01 0x00 0x00 0x01 0x00 0x00 0x3d 0x01 0x00 0x00 0x01 0x00 0x00 0x3e 0x01 0x00 0x00 0x01 0x00 0x00 0x3f 0x01 0x00 0x00 0x01 0x00 0x00 0x40 0x01 0x00 0x00 0x01 0x00 0x00 0x41 0x02 0x00 0x00 0x01 0x00 0x00 0x42 0x02 0x00 0x00 0x01 0x00 0x00 0x43 0x01 0x00 0x00 0x01 0x00 0x00 0x44 0x01 0x00 0x00 0x01 0x00 0x00 0x45 0x01 0x01 0x00 0x01 0x00 0x00 0x46 0x01 0x01 0x00 0x01 0x00 0x00 0x47 0x01 0x01 0x00 0x01 0x00 0x00 0x48 0x01 0x01 0x00 0x01 0x00 0x00 0x49 0x01 0x01 0x00 0x01 0x00 0x00 0x4a 0x01 0x01 0x00 0x01 0x00 0x00 0x4b 0x01 0x01 0x00 0x01 0x00 0x00 0x4c 0x01 0x01 0x00 0x01 0x00 0x00 0x4d 0x01 0x01 0x00 0x01 0x00 0x00 0x4e 0x00 0x01 0x00 0x00 0x00 0x00 0x4f 0x00 0x01 0x00 0x00 0x00 0x00 0x50 0x01 0x00 0x00 0x01 0x00 0x00 0x51 0x01 0x00 0x00 0x01 0x01 0x00 0x52 0x01 0x00 0x00 0x01 0x01 0x00 0x53 0x01 0x00 0x00 0x01 0x01 0x00 0x54 0x01 0x00 0x00 0x01 0x01 0x00 0x55 0x01 0x00 0x00 0x01 0x01 0x00 0x56 0x01 0x01 0x00 0x01 0x00 0x00 0x57 0x01 0x01 0x00 0x01 0x00 0x00 0x58 0x01 0x01 0x00 0x01 0x00 0x00 0x59 0x01 0x00 0x00 0x01 0x00 0x00 0x5a 0x01 0x01 0x00 0x00 0x00 0x00 0x5b 0x01 0x01 0x00 0x01 0x00 0x00 0x5c 0x01 0x01 0x00 0x01 0x00 0x00 0x5d 0x01 0x00 0x00 0x01 0x01 0x00 0x5e 0x01 0x00 0x00 0x01 0x01 0x00 0x5f 0x01 0x00 0x00 0x01 0x01 0x00 0x60 0x01 0x01 0x00 0x00 0x00 0x00 0x61 0x00 0x01 0x00 0x00 0x00 0x00 0x62 0x00 0x01 0x00 0x00 0x00 0x00 0x63 0x00 0x01 0x00 0x00 0x00 0x00 0x64 0x00 0x01 0x00 0x00 0x00 0x00 0x65 0x00 0x01 0x00 0x00 0x00 0x00 0x66 0x00 0x01 0x00 0x00 0x00 0x00 0x67 0x01 0x00 0x00 0x01 0x01 0x00 0x68 0x01 0x00 0x00 0x01 0x01 0x00 0x69 0x01 0x00 0x00 0x01 0x01 0x00 0x6a 0x01 0x00 0x00 0x01 0x01 0x00 0x6b 0x00 0x01 0x00 0x00 0x00 0x00 0x6c 0x00 0x01 0x00 0x00 0x00 0x00 0x6d 0x00 0x01 0x00 0x00 0x00 0x00 0x6e 0x00 0x01 0x00 0x00 0x00 0x00 0x6f 0x01 0x01 0x00 0x00 0x00 0x00 0x70 0x00 0x01 0x00 0x00 0x00 0x00 0x71 0x00 0x00 0x00 0x01 0x00 0x00 0x72 0x00 0x00 0x00 0x01 0x00 0x00 0x73 0x00 0x00 0x00 0x01 0x00 0x00 0x74 0x00 0x00 0x00 0x01 0x00 0x00 0x75 0x00 0x00 0x00 0x01 0x00 0x00 0x76 0x00 0x00 0x00 0x01 0x00 0x00 0x77 0x00 0x00 0x00 0x01 0x00 0x00 0x78 0x00 0x00 0x00 0x01 0x00 0x00 0x79 0x00 0x00 0x00 0x01 0x00 0x00 0x7a 0x01 0x00 0x00 0x01 0x01 0x00 0x7b 0x01 0x00 0x00 0x01 0x01 0x00 0x7c 0x01 0x01 0x00 0x00 0x00 0x00 0x7d 0x01 0x00 0x00 0x01 0x01 0x00 0x7e 0x01 0x00 0x00 0x01 0x01 0x00 0x7f 0x01 0x00 0x00 0x01 0x01 0x00 0x80 0x01 0x00 0x00 0x01 0x01 0x00 0x81 0x01 0x00 0x00 0x01 0x01 0x00 0x82 0x01 0x00 0x00 0x01 0x01 0x00 0x83 0x01 0x00 0x00 0x01 0x00 0x00 0x84 0x01 0x00 0x00 0x01 0x01 0x00 0x85 0x01 0x01 0x00 0x00 0x00 0x00 0x86 0x01 0x00 0x00 0x01 0x00 0x01 0x87 0x01 0x01 0x00 0x00 0x00 0x00 0x88 0x01 0x01 0x00 0x01 0x00 0x00 0x89 0x01 0x01 0x00 0x01 0x00 0x00 0x8a 0x01 0x01 0x00 0x00 0x00 0x00 0x8b 0x01 0x01 0x00 0x01 0x00 0x00 0x8c 0x01 0x00 0x00 0x00 0x00 0x00 0x8d 0x01 0x00 0x00 0x00 0x00 0x00 0x8e 0x01 0x00 0x00 0x00 0x00 0x00 0x8f 0x01 0x00 0x00 0x00 0x00 0x00 0x90 0x01 0x00 0x00 0x01 0x00 0x00 0x91 0x01 0x01 0x00 0x00 0x00 0x00 0x92 0x01 0x00 0x00 0x01 0x00 0x00 0x93 0x01 0x01 0x00 0x00 0x00 0x00 0x94 0x01 0x01 0x00 0x00 0x00 0x00 0x95 0x01 0x01 0x00 0x00 0x00 0x00 0x96 0x00 0x01 0x00 0x00 0x00 0x00 0x97 0x00 0x01 0x00 0x00 0x00 0x00 0x98 0x00 0x01 0x00 0x00 0x00 0x00 0x99 0x00 0x01 0x00 0x00 0x00 0x00 0x9a 0x01 0x01 0x00 0x00 0x00 0x00 0x9b 0x00 0x01 0x00 0x01 0x00 0x00 0x9c 0x00 0x01 0x00 0x00 0x00 0x00 0x9d 0x00 0x01 0x00 0x00 0x00 0x00 0x9e 0x00 0x01 0x00 0x00 0x00 0x00 0x9f 0x00 0x01 0x00 0x00 0x00 0x00 0xa0 0x00 0x01 0x00 0x00 0x00 0x00 0xa1 0x02 0x00 0x00 0x01 0x00 0x00 0xa2 0x02 0x01 0x00 0x00 0x00 0x00 0xa3 0x02 0x01 0x00 0x00 0x00 0x00 0xa4 0x02 0x01 0x00 0x00 0x00 0x00 0xa5 0x00 0x01 0x00 0x00 0x00 0x00 0xa6 0x00 0x01 0x00 0x00 0x00 0x00 0xa7 0x01 0x01 0x00 0x01 0x00 0x00 0xa8 0x01 0x01 0x00 0x01 0x00 0x00 0xa9 0x00 0x01 0x00 0x00 0x00 0x00 0xaa 0x02 0x01 0x00 0x01 0x00 0x00 0xab 0x02 0x01 0x00 0x01 0x00 0x00 0xac 0x02 0x01 0x00 0x01 0x00 0x00 0xad 0x00 0x00 0x00 0x01 0x00 0x00 0xae 0x02 0x00 0x00 0x01 0x00 0x00 0xaf 0x00 0x01 0x00 0x00 0x00 0x00 0xb0 0x00 0x01 0x00 0x00 0x00 0x00 0xb1 0x00 0x01 0x00 0x00 0x00 0x00 0xb2 0x00 0x01 0x00 0x00 0x00 0x00 0xb3 0x00 0x01 0x00 0x00 0x00 0x00 0xb4 0x00 0x00 0x00 0x01 0x00 0x00 0xb5 0x00 0x00 0x00 0x01 0x00 0x00 0xb6 0x00 0x00 0x00 0x01 0x00 0x00 0xb7 0x00 0x00 0x00 0x01 0x00 0x00 0xb8 0x00 0x00 0x00 0x01 0x00 0x00 0xb9 0x00 0x00 0x00 0x01 0x00 0x00 0xba 0x00 0x00 0x00 0x01 0x00 0x00 0xbb 0x00 0x00 0x00 0x01 0x00 0x00 0xbc 0x00 0x00 0x00 0x01 0x00 0x00 0xbd 0x00 0x00 0x00 0x01 0x00 0x00 0xbe 0x00 0x00 0x00 0x01 0x00 0x00 0xbf 0x00 0x00 0x00 0x01 0x00 0x00>;
		};
	};

	fragment@69 {
		target = <0xffffffff>;

		__overlay__ {
			deb-gpios = <0xffffffff 0x00 0x00>;
			debounce = <0x7d000>;
			interrupt-parent = <0xffffffff>;
			interrupts = <0x00 0x08 0x00 0x00>;
			status = "okay";
		};
	};

	fragment@7 {
		target = <0xffffffff>;

		__overlay__ {
			direction = <0x03>;
			firlen = <0x00>;
			i2c_addr = <0x0f 0x00 0x00 0x00>;
			i2c_num = <0x01>;
			is_batch_supported = <0x00>;
			power_id = <0xffff>;
			power_vol = <0x00>;
		};
	};

	fragment@70 {
		target = <0xffffffff>;

		__overlay__ {
			interrupt-parent = <0xffffffff>;
			interrupts = <0x01 0x02 0x01 0x00>;
			status = "okay";
		};
	};

	fragment@71 {
		target = <0xffffffff>;

		__overlay__ {
			deb-gpios = <0xffffffff 0x03 0x00>;
			debounce = <0x3e800>;
			interrupt-parent = <0xffffffff>;
			interrupts = <0x03 0x04 0x03 0x00>;
			status = "okay";
		};
	};

	fragment@72 {
		target = <0xffffffff>;

		__overlay__ {
			interrupt-parent = <0xffffffff>;
			interrupts = <0x04 0x08 0x04 0x00>;
			status = "okay";
		};
	};

	fragment@73 {
		target = <0xffffffff>;

		__overlay__ {
			interrupt-parent = <0xffffffff>;
			interrupts = <0x05 0x08 0x05 0x00>;
			status = "okay";
		};
	};

	fragment@74 {
		target = <0xffffffff>;

		__overlay__ {
			interrupt-parent = <0xffffffff>;
			interrupts = <0x06 0x08 0x06 0x00>;
			status = "okay";
		};
	};

	fragment@75 {
		target = <0xffffffff>;

		__overlay__ {
			deb-gpios = <0xffffffff 0x07 0x00>;
			debounce = <0x3e800>;
			interrupt-parent = <0xffffffff>;
			interrupts = <0x07 0x08 0x07 0x00>;
			status = "okay";
		};
	};

	fragment@76 {
		target = <0xffffffff>;

		__overlay__ {
			interrupt-parent = <0xffffffff>;
			interrupts = <0x08 0x08 0x08 0x00>;
			status = "okay";
		};
	};

	fragment@77 {
		target = <0xffffffff>;

		__overlay__ {
			interrupt-parent = <0xffffffff>;
			interrupts = <0x09 0x08 0x09 0x00>;
			status = "okay";
		};
	};

	fragment@78 {
		target = <0xffffffff>;

		__overlay__ {
			interrupt-parent = <0xffffffff>;
			interrupts = <0x0a 0x08 0x0a 0x00>;
			status = "okay";
		};
	};

	fragment@79 {
		target = <0xffffffff>;

		__overlay__ {
			interrupt-parent = <0xffffffff>;
			interrupts = <0x15 0x04 0x15 0x00>;
			status = "okay";
		};
	};

	fragment@8 {
		target = <0xffffffff>;

		__overlay__ {
			als_level = <0x05 0x09 0x24 0x3b 0x52 0x84 0xcd 0x111 0x1f4 0x34d 0x470 0x609 0x93c 0x122f 0x1b46>;
			als_value = <0x00 0x3c 0x50 0x73 0x91 0xb4 0xde 0x168 0x1cc 0x226 0x3a2 0x4e2 0x6a4 0xa28 0x1400 0x1e00 0x2800>;
			i2c_addr = <0x48 0x00 0x00 0x00>;
			i2c_num = <0x01>;
			is_batch_supported_als = <0x00>;
			is_batch_supported_ps = <0x00>;
			polling_mode_als = <0x01>;
			polling_mode_ps = <0x00>;
			power_id = <0xffff>;
			power_vol = <0x00>;
			ps_threshold_high = <0x5a>;
			ps_threshold_low = <0x46>;
		};
	};

	fragment@80 {
		target = <0xffffffff>;

		__overlay__ {
			interrupt-parent = <0xffffffff>;
			interrupts = <0x1a 0x08 0x1a 0x00>;
			status = "okay";
		};
	};

	fragment@81 {
		target = <0xffffffff>;

		__overlay__ {
			interrupt-parent = <0xffffffff>;
			interrupts = <0x29 0x08 0x29 0x00>;
			status = "okay";
		};
	};

	fragment@82 {
		target = <0xffffffff>;

		__overlay__ {
			interrupt-parent = <0xffffffff>;
			interrupts = <0x2c 0x01 0x2c 0x01>;
			status = "okay";
		};
	};

	fragment@83 {
		target = <0xffffffff>;

		__overlay__ {
			interrupt-parent = <0xffffffff>;
			interrupts = <0xb6 0x04 0xbe 0x00>;
			status = "okay";
		};
	};

	fragment@84 {
		target = <0xffffffff>;

		__overlay__ {
			interrupt-parent = <0xffffffff>;
			interrupts = <0xba 0x08 0xad 0x00>;
			status = "okay";
		};
	};

	fragment@85 {
		target = <0xffffffff>;

		__overlay__ {
			compatible = "mediatek,md1_sim1_hot_plug_eint-eint";
			debounce = <0x00 0x186a0>;
			dedicated = <0x00 0x00>;
			interrupts = <0x00 0x08>;
			sockettype = <0x00 0x00>;
			src_pin = <0x00 0x01>;
			status = "okay";
		};
	};

	fragment@86 {
		target = <0xffffffff>;

		__overlay__ {
			compatible = "mediatek,md1_sim2_hot_plug_eint-eint";
			debounce = <0x01 0x186a0>;
			dedicated = <0x01 0x00>;
			interrupts = <0x01 0x08>;
			sockettype = <0x01 0x00>;
			src_pin = <0x01 0x02>;
			status = "okay";
		};
	};

	fragment@87 {
		target = <0xffffffff>;

		__overlay__ {
			regulator-default-on = <0x01>;
			regulator-name = "vcama1";
			status = "okay";
		};
	};

	fragment@88 {
		target = <0xffffffff>;

		__overlay__ {
			regulator-default-on = <0x01>;
			regulator-name = "vcama2";
			status = "okay";
		};
	};

	fragment@89 {
		target = <0xffffffff>;

		__overlay__ {
			regulator-default-on = <0x01>;
			regulator-name = "vsim1";
			status = "okay";
		};
	};

	fragment@9 {
		target = <0xffffffff>;

		__overlay__ {
			als_level = <0x00 0x148 0x35d 0x561 0xc35 0x1e29 0x1e57 0x314d 0x5a16 0x6f0e 0x81fa 0xb80c 0xe15e 0xe15e 0xffff>;
			als_value = <0x00 0x85 0x130 0x1f6 0x3ec 0x7d5 0xbf2 0x138d 0x1f48 0x271a 0x2ee0 0x3e80 0x4e20 0x4e20 0x4e20 0x4e20>;
			i2c_addr = <0x23 0x00 0x00 0x00>;
			i2c_num = <0x01>;
			is_batch_supported_als = <0x00>;
			is_batch_supported_ps = <0x00>;
			polling_mode_als = <0x01>;
			polling_mode_ps = <0x00>;
			power_id = <0xffff>;
			power_vol = <0x00>;
			ps_threshold_high = <0x46>;
			ps_threshold_low = <0x28>;
		};
	};

	fragment@90 {
		target = <0xffffffff>;

		__overlay__ {
			regulator-default-on = <0x01>;
			regulator-name = "vsim2";
			status = "okay";
		};
	};

	fragment@91 {
		target = <0xffffffff>;

		__overlay__ {
			regulator-default-on = <0x01>;
			regulator-name = "vcamd";
			status = "okay";
		};
	};

	fragment@92 {
		target = <0xffffffff>;

		__overlay__ {
			regulator-default-on = <0x01>;
			regulator-name = "vcamio";
			status = "okay";
		};
	};

	fragment@93 {
		target = <0xffffffff>;

		__overlay__ {
			regulator-default-on = <0x01>;
			regulator-name = "vldo28";
			status = "okay";
		};
	};

	fragment@94 {
		target = <0xffffffff>;

		__overlay__ {
			status = "okay";
			vcama-supply = <0xffffffff>;
			vcama_sub-supply = <0xffffffff>;
			vcamaf-supply = <0xffffffff>;
			vcamaf_main2-supply = <0xffffffff>;
			vcamaf_sub-supply = <0xffffffff>;
			vcamd_sub-supply = <0xffffffff>;
			vcamio-supply = <0xffffffff>;
			vcamio_main2-supply = <0xffffffff>;
			vcamio_sub-supply = <0xffffffff>;
			vcamio_sub2-supply = <0xffffffff>;
		};
	};

	fragment@95 {
		target = <0xffffffff>;

		__overlay__ {
			status = "okay";
			vtouch-supply = <0xffffffff>;
		};
	};

	fragment@96 {
		target = <0xffffffff>;

		__overlay__ {
			mediatek,kpd-hw-dl-key0 = <0x11>;
			mediatek,kpd-hw-dl-key1 = <0x00>;
			mediatek,kpd-hw-dl-key2 = <0x08>;
			mediatek,kpd-hw-factory-key = <0x00>;
			mediatek,kpd-hw-init-map = <0x72 0x00 0x00 0x00 0x00 0x00 0x00 0x00 0x00 0x00 0x00 0x00 0x00 0x00 0x00 0x00 0x00 0x00 0x00 0x00 0x00 0x00 0x00 0x00 0x00 0x00 0x00 0x00 0x00 0x00 0x00 0x00 0x00 0x00 0x00 0x00 0x00 0x00 0x00 0x00 0x00 0x00 0x00 0x00 0x00 0x00 0x00 0x00 0x00 0x00 0x00 0x00 0x00 0x00 0x00 0x00 0x00 0x00 0x00 0x00 0x00 0x00 0x00 0x00 0x00 0x00 0x00 0x00 0x00 0x00 0x00 0x00>;
			mediatek,kpd-hw-map-num = <0x48>;
			mediatek,kpd-hw-pwrkey = <0x08>;
			mediatek,kpd-hw-recovery-key = <0x11>;
			mediatek,kpd-hw-rstkey = <0x11>;
			mediatek,kpd-key-debounce = <0x400>;
			mediatek,kpd-pwkey-gpio-din = <0x00>;
			mediatek,kpd-pwrkey-eint-gpio = <0x00>;
			mediatek,kpd-sw-pwrkey = <0x74>;
			mediatek,kpd-sw-rstkey = <0x73>;
			mediatek,kpd-use-extend-type = <0x00>;
			status = "okay";
		};
	};
};
